## firmware/boards/xiao_ble_nrf52840_sense.conf
```kconfig
# Seeed Studio XIAO BLE Sense (xiao_ble/nrf52840/sense)
# Flash via the factory UF2 bootloader: double-tap reset → copy zephyr.uf2 to XIAO-SENSE.
# CONFIG_BUILD_OUTPUT_UF2 and CONFIG_REGULATOR are already on in the board defconfig.
# For MCUboot-signed production images use FILE_SUFFIX=release.

# Tap input source:
#   - LSM6DS3TR-C IMU: dead on both physical units (see project memory) — off.
#   - PDM mic: hardware works in the smoke-test build but production capture
#     wedges into constant DC; investigation deferred (see conversation_018).
#   - GPIO button: external push-button wired between XIAO D0 (P0.02) and GND;
#     selected here so the gesture state machine can be exercised end-to-end.
CONFIG_CANTIL_INPUT_IMU=n
CONFIG_CANTIL_INPUT_MIC=n
CONFIG_CANTIL_INPUT_BUTTON=y
CONFIG_GPIO=y

# RGB LED — driven via pwm-leds (overlay rebinds pwm0 to GPIOs 0:26/30/6).
# Enables HSV rendering for orange↔red crossfade, rainbow sweep, and per-tap
# dim-white feedback. See firmware/src/led/led.c.
CONFIG_PWM=y
CONFIG_LED=y
CONFIG_LED_PWM=y
CONFIG_CANTIL_TRANSPORT_USB=y
CONFIG_CANTIL_STORAGE_EXTERNAL=y

# Old USB device stack. USB_DEVICE_INITIALIZE_AT_BOOT (set by board dtsi)
# handles enumeration at APPLICATION SYS_INIT time.
CONFIG_USB_CDC_ACM=y
CONFIG_UART_LINE_CTRL=y

# BLE is intentionally not enabled in the default (FREE crypto backend) build.
# Zephyr's BT stack pulls in CONFIG_BT_HOST_CRYPTO, which auto-implies
# NRF_SECURITY, which in turn requires a PSA crypto driver (Oberon or CC3XX)
# to back AES/SHA — both are closed-source under the Nordic 5-Clause license
# and would taint the GPLv3 default build.  When the ACCELERATED crypto
# backend is implemented (LICENSE-EXCEPTIONS.md proprietary-crypto opt-in),
# add the BLE switches back via a separate _ble.conf overlay loaded with
# FILE_SUFFIX=ble or EXTRA_CONF_FILE.  Source-tree transport_ble.c stays
# in place; only the build-time toggle is deferred.

# External QSPI flash — hardware configured by board DTS; enable drivers explicitly
CONFIG_FLASH=y
CONFIG_NORDIC_QSPI_NOR=y
CONFIG_NORDIC_QSPI_NOR_FLASH_LAYOUT_PAGE_SIZE=4096
CONFIG_MPU_ALLOW_FLASH_WRITE=y

# NCS Partition Manager: put the LittleFS partition on external QSPI flash (full 2 MB)
CONFIG_PM_PARTITION_REGION_LITTLEFS_EXTERNAL=y
CONFIG_PM_PARTITION_SIZE_LITTLEFS=0x200000

# IMU — LSM6DS3TR-C on I2C (board DTS: lsm6ds3tr_c @ i2c0 0x6a, irq gpio0 11).
# tap_imu.c programs the chip directly via I2C; the Zephyr LSM6DSL driver
# must NOT be enabled — both writers would fight over the chip's config
# registers and leave the bus in an unknown state.
CONFIG_I2C=y
CONFIG_SENSOR=n
CONFIG_LSM6DSL=n
```

## firmware/boards/xiao_ble_nrf52840_sense_diag.conf
```kconfig
# Diagnostic: all base board config, BT/MPSL disabled.
# FILE_SUFFIX replaces the base board conf so this must be self-contained.
# If USB enumerates with this build → MPSL/BT init was crashing the full build.

CONFIG_CANTIL_INPUT_IMU=y
CONFIG_CANTIL_TRANSPORT_USB=y
CONFIG_CANTIL_TRANSPORT_BLE=n
# Storage disabled — LittleFS mount could crash during USB enumeration window
CONFIG_CANTIL_STORAGE_EXTERNAL=n

# USB (old stack). Let USB_DEVICE_INITIALIZE_AT_BOOT handle enumeration at
# APPLICATION SYS_INIT time. Our transport_usb_init() calls usb_enable()
# too (handles -EALREADY), but the SYS_INIT path is what actually asserts D+.
CONFIG_USB_CDC_ACM=y
CONFIG_UART_LINE_CTRL=y

# BLE disabled — this removes MPSL which init at PRE_KERNEL_1 before USB
CONFIG_BT=n

# External QSPI flash
CONFIG_FLASH=y
CONFIG_NORDIC_QSPI_NOR=y
CONFIG_NORDIC_QSPI_NOR_FLASH_LAYOUT_PAGE_SIZE=4096
CONFIG_MPU_ALLOW_FLASH_WRITE=y

# NCS PM: LittleFS on external flash (full 2 MB)
CONFIG_PM_PARTITION_REGION_LITTLEFS_EXTERNAL=y
CONFIG_PM_PARTITION_SIZE_LITTLEFS=0x200000

# IMU — LSM6DS3TR-C on I2C.
#
# Diagnostic-only: re-enable the upstream Zephyr LSM6DSL sensor driver
# alongside our direct-I2C tap_imu.c. We want to read its init verdict
# (device_is_ready) to find out whether the upstream driver can talk to
# the chip at all. In production this driver stays disabled per the
# comment in tap_imu.c (it only supports DATA_READY triggers).
CONFIG_I2C=y
CONFIG_SENSOR=y
CONFIG_LSM6DSL=y
CONFIG_LSM6DSL_TRIGGER_NONE=y
CONFIG_SENSOR_LOG_LEVEL_DBG=y

# UART console over CDC ACM. The board overlay aliases zephyr,console to
# cdc_acm_uart0; USB_DEVICE_INITIALIZE_AT_BOOT brings the link up before
# main() so by the time gesture_init() runs, /dev/ttyACM0 is live on the host.
CONFIG_UART_CONSOLE=y
CONFIG_LOG=y
CONFIG_LOG_DEFAULT_LEVEL=3
CONFIG_LOG_BACKEND_UART=y
CONFIG_LOG_PRINTK=y

# POST_KERNEL diagnostic blinks: pinpoints which init stage crashes
CONFIG_CANTIL_DIAG_BOOT=y

CONFIG_ARM_MPU=y
CONFIG_HW_STACK_PROTECTION=y
```

## firmware/boards/xiao_ble_nrf52840_sense_mcuboot.conf
```kconfig
# XIAO BLE Sense — MCUboot-only tier (maximum security, production).
# Build with:
#   ./scripts/dbox.sh bash scripts/build.sh \
#       --bootloader mcuboot \
#       --signing-key ~/.cantil/firmware-signing/fw_signing.key.pem
#
# Flash layout: dual internal slots (~486 KB each).  No UF2; no QSPI needed
# for firmware updates.  Recovery via SWD only.
#
# FILE_SUFFIX=mcuboot replaces (not extends) xiao_ble_nrf52840_sense.conf,
# so all hardware settings must be included here.

CONFIG_CANTIL_BOOTLOADER_MCUBOOT=y

# MCUboot integration (sysbuild builds mcuboot child image alongside the app).
CONFIG_BOOTLOADER_MCUBOOT=y

# In-app MCUboot management: boot_request_upgrade / boot_is_img_confirmed /
# boot_write_img_confirmed (used by fw_update module).
# STREAM_FLASH is a dependency of IMG_MANAGER; IMG_MANAGER contains the
# MCUBOOT_IMG_MANAGER choice, which selects MCUBOOT_BOOTUTIL_LIB.
CONFIG_STREAM_FLASH=y
CONFIG_IMG_MANAGER=y
CONFIG_MCUBOOT_IMG_MANAGER=y

# No UF2 output — updates go through UPDATE_FIRMWARE opcode over Noise only.
CONFIG_BUILD_OUTPUT_UF2=n

# Strict session identity check required for production.
CONFIG_CANTIL_SESSION_X509_STRICT=y

# ── Hardware settings (from xiao_ble_nrf52840_sense.conf base) ──────────────
CONFIG_CANTIL_INPUT_IMU=n
CONFIG_CANTIL_INPUT_MIC=n
CONFIG_CANTIL_INPUT_BUTTON=y
CONFIG_GPIO=y

CONFIG_PWM=y
CONFIG_LED=y
CONFIG_LED_PWM=y
CONFIG_CANTIL_TRANSPORT_USB=y
CONFIG_CANTIL_STORAGE_EXTERNAL=y

CONFIG_USB_CDC_ACM=y
CONFIG_UART_LINE_CTRL=y

CONFIG_FLASH=y
CONFIG_NORDIC_QSPI_NOR=y
CONFIG_NORDIC_QSPI_NOR_FLASH_LAYOUT_PAGE_SIZE=4096
CONFIG_MPU_ALLOW_FLASH_WRITE=y

# NCS Partition Manager: LittleFS on full external QSPI (secondary slot is
# internal, so full 2 MB is available for key/cert storage).
CONFIG_PM_PARTITION_REGION_LITTLEFS_EXTERNAL=y
CONFIG_PM_PARTITION_SIZE_LITTLEFS=0x200000

CONFIG_I2C=y
CONFIG_SENSOR=n
CONFIG_LSM6DSL=n
```

## firmware/boards/xiao_ble_nrf52840_sense_rehearsal.conf
```kconfig
# Gesture / LED rehearsal build — identical to the base config plus the
# rehearsal flag. FILE_SUFFIX replaces the base conf so this must be a full
# copy (with the one extra line).
#
# Build:   ./scripts/dbox.sh bash scripts/build.sh -- -DFILE_SUFFIX=rehearsal
# Flash:   ./scripts/dbox.sh bash scripts/build.sh --flash -- -DFILE_SUFFIX=rehearsal
#
# How to drive it (everything happens on-device; no host needed):
#   LOCKED         tap unlock seq      ST DT ST DT       → UNLOCKED (green twin pulse)
#   UNLOCKED       pair trigger        DT DT ST ST       → PAIRING (magenta fast)
#   UNLOCKED       change-seq trigger  DT ST DT ST       → READY (yellow long pulse)
#                  then new seq                          → VERIFY (yellow two pulses)
#                  then re-enter seq                     → UNLOCKED or FAIL
#   UNLOCKED       simulate PROTECT    DT DT DT DT       → CONFIRM_PROMPT (yellow steady)
#                  then DT DT DT                         → CONFIRMED (green long) or FAIL
#   UNLOCKED       simulate RESET      ST ST ST ST       → RESET_PROMPT (red urgent)
#                  then current unlock seq               → CONFIRMED (green long) or FAIL
#   any state      wrong sequence                        → FAIL (red fast burst)

CONFIG_CANTIL_INPUT_IMU=y
CONFIG_CANTIL_TRANSPORT_USB=y
CONFIG_CANTIL_TRANSPORT_BLE=y
CONFIG_CANTIL_STORAGE_EXTERNAL=y

# >>> Rehearsal-only addition <<<
CONFIG_CANTIL_GESTURE_REHEARSAL=y

# Old USB device stack. USB_DEVICE_INITIALIZE_AT_BOOT (set by board dtsi)
# handles enumeration at APPLICATION SYS_INIT time.
CONFIG_USB_CDC_ACM=y
CONFIG_UART_LINE_CTRL=y

# BLE
CONFIG_BT=y
CONFIG_BT_PERIPHERAL=y
CONFIG_BT_NUS=y
CONFIG_BT_SMP=y
CONFIG_BT_PRIVACY=y
CONFIG_BT_BONDABLE=y
CONFIG_BT_MAX_CONN=1
CONFIG_BT_MAX_PAIRED=4

# External QSPI flash — hardware configured by board DTS; enable drivers explicitly
CONFIG_FLASH=y
CONFIG_NORDIC_QSPI_NOR=y
CONFIG_NORDIC_QSPI_NOR_FLASH_LAYOUT_PAGE_SIZE=4096
CONFIG_MPU_ALLOW_FLASH_WRITE=y

# NCS Partition Manager: put the LittleFS partition on external QSPI flash (full 2 MB)
CONFIG_PM_PARTITION_REGION_LITTLEFS_EXTERNAL=y
CONFIG_PM_PARTITION_SIZE_LITTLEFS=0x200000

# IMU — LSM6DS3TR-C on I2C. tap_imu.c programs the chip directly via I2C
# (bypassing the Zephyr LSM6DSL driver, which only supports DATA_READY
# triggers). We need the I2C bus and the GPIO interrupt line; everything
# else the chip needs is set up by tap_imu_init().
CONFIG_I2C=y
# Zephyr LSM6DSL sensor driver explicitly NOT enabled to avoid two writers
# fighting for the chip's config registers.

# Regulator framework left ON so the lsm6ds3tr-c-en regulator-boot-on node
# actually enables the IMU. We earlier tried driving P1.08 ourselves and the
# chip stayed silent on I2C, suggesting our raw GPIO toggle wasn't bringing
# the load switch up.
CONFIG_REGULATOR=y
CONFIG_REGULATOR_FIXED=y
```
