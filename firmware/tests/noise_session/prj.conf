## CMakeLists.txt
```
# SPDX-License-Identifier: GPL-3.0-or-later
#
# Tier-2 conformance: drive session.c through a loopback transport on
# native_sim, with the responder's static + ephemeral keypairs injected
# from a precomputed Noise_XX_25519_ChaChaPoly_SHA256 trace.  Two ZTEST
# suites run in parallel:
#   - noise_session            — fixed 0x11/0x22/0x33/0x44 keys (regression)
#   - noise_session_cacophony  — keys from the published Cacophony reference
#     vector, re-derived through primitives that have been independently
#     validated against the full Cacophony trace (gen_cacophony_vector.py).
#
# Build (native_sim needs the host toolchain, not gnuarmemb):
#   ZEPHYR_TOOLCHAIN_VARIANT=host \
#     west build -p -b native_sim firmware/tests/noise_session --no-sysbuild
#   west build -t run
#
# Regenerate vectors after touching noise_xx_ref.py:
#   python3 gen_xx_vector.py
#   python3 gen_cacophony_vector.py   # also validates against cacophony.txt

cmake_minimum_required(VERSION 3.20.0)

find_package(Zephyr REQUIRED HINTS $ENV{ZEPHYR_BASE})
project(noise_session_tests LANGUAGES C)

set(FW ${CMAKE_CURRENT_SOURCE_DIR}/../..)

target_sources(app PRIVATE
    src/main.c
    src/main_cacophony.c
    src/loopback.c
    src/test_inject.c
    ${FW}/src/session/session.c
    ${FW}/src/session/noise_crypto_wolfssl.c
    ${FW}/src/crypto/wc_rand.c
    ${FW}/src/crypto/zeroize.c
    ${FW}/../common/cbor/cantil_cbor.c
)

target_include_directories(app PRIVATE
    src
    ${FW}/src
    ${FW}/src/session
    ${FW}/../common/cbor
)

# cantil_wolfssl_user_settings.h lives here.
zephyr_include_directories(${FW}/include)

# Carries WOLFSSL_USER_SETTINGS / WOLFSSL_ZEPHYR defines.
target_link_libraries(app PRIVATE wolfSSL)
```

## Kconfig
```
# SPDX-License-Identifier: GPL-3.0-or-later

mainmenu "noise_session ztest"

# Mirror of firmware/Kconfig:CANTIL_TEST_INJECT_NOISE_KEYS — defined locally so
# this test app can be built standalone against Kconfig.zephyr without pulling
# in the full firmware Kconfig tree (USB/BLE/storage etc).  Keep the symbol
# name in sync with the production definition; session.c keys off it via
# #ifdef regardless of which Kconfig tree defined it.
config CANTIL_TEST_INJECT_NOISE_KEYS
	bool "Test-only: inject Noise static + ephemeral keypairs"
	default y

source "Kconfig.zephyr"
```

## prj.conf
```kconfig
# ztest framework
CONFIG_ZTEST=y

# Inject Noise static + ephemeral keypairs from a precomputed vector so the
# responder's wire output is bit-deterministic against the reference trace.
CONFIG_CANTIL_TEST_INJECT_NOISE_KEYS=y

# Entropy needed by the wolfCrypt RNG (used internally even when
# we never call noise_crypto_dh_keygen directly).
CONFIG_ENTROPY_GENERATOR=y
CONFIG_TEST_RANDOM_GENERATOR=y


CONFIG_MAIN_STACK_SIZE=8192
CONFIG_HEAP_MEM_POOL_SIZE=16384

# wolfCrypt — primitives selected by the settings header, not Kconfig.
CONFIG_WOLFSSL=y
CONFIG_WOLFSSL_BUILTIN=y
CONFIG_WOLFSSL_SETTINGS_FILE="cantil_wolfssl_user_settings.h"
```

## src/main.c
```c
/* SPDX-License-Identifier: GPL-3.0-or-later */
/* See LICENSE at the repo root. */

/*
 * Self-generated vector entry: drives session.c against the
 * deterministic Noise_XX trace in xx_vector.h (fixed 0x11/0x22/0x33/0x44
 * keys).  Primary regression suite.
 */

#include "xx_vector.h"

#define SUITE_NAME noise_session

#include "noise_session_tests.inc"
```

## src/loopback.c
```c
/* SPDX-License-Identifier: GPL-3.0-or-later */
/* See LICENSE at the repo root. */

#include <string.h>
#include <errno.h>
#include <zephyr/kernel.h>

#include "loopback.h"

static void pipe_init(struct loopback_pipe *p)
{
	p->head = 0;
	p->tail = 0;
	k_mutex_init(&p->lock);
	k_sem_init(&p->data_avail, 0, K_SEM_MAX_LIMIT);
}

static int pipe_write(struct loopback_pipe *p, const uint8_t *buf, size_t len)
{
	k_mutex_lock(&p->lock, K_FOREVER);
	if (p->tail + len > LOOPBACK_BUF_LEN) {
		k_mutex_unlock(&p->lock);
		return -ENOBUFS;
	}
	memcpy(p->buf + p->tail, buf, len);
	p->tail += len;
	k_mutex_unlock(&p->lock);
	k_sem_give(&p->data_avail);
	return 0;
}

/*
 * Non-blocking drain: copy out whatever is currently buffered (up to max_len),
 * return immediately even if buffer is empty.  session.c's raw_recv_exact
 * handles the spin-wait via k_msleep when recv reports 0 bytes.
 */
static int pipe_read_nonblock(struct loopback_pipe *p, uint8_t *out, size_t max_len,
			      size_t *received)
{
	k_mutex_lock(&p->lock, K_FOREVER);
	size_t avail = p->tail - p->head;
	size_t n = avail < max_len ? avail : max_len;

	if (n > 0) {
		memcpy(out, p->buf + p->head, n);
		p->head += n;
		/* Compact when fully drained to keep buffer usable for next msg. */
		if (p->head == p->tail) {
			p->head = 0;
			p->tail = 0;
		}
	}
	k_mutex_unlock(&p->lock);
	*received = n;
	return 0;
}

/* ── cantil_transport_t vtable ───────────────────────────────────────────── */

static int side_a_send(cantil_transport_t *t, const uint8_t *buf, size_t len)
{
	struct loopback_pair *pair = (struct loopback_pair *)t->priv;

	return pipe_write(&pair->a_to_b, buf, len);
}

static int side_a_recv(cantil_transport_t *t, uint8_t *buf, size_t max_len, size_t *received)
{
	struct loopback_pair *pair = (struct loopback_pair *)t->priv;

	return pipe_read_nonblock(&pair->b_to_a, buf, max_len, received);
}

static int side_b_send(cantil_transport_t *t, const uint8_t *buf, size_t len)
{
	struct loopback_pair *pair = (struct loopback_pair *)t->priv;

	return pipe_write(&pair->b_to_a, buf, len);
}

static int side_b_recv(cantil_transport_t *t, uint8_t *buf, size_t max_len, size_t *received)
{
	struct loopback_pair *pair = (struct loopback_pair *)t->priv;

	return pipe_read_nonblock(&pair->a_to_b, buf, max_len, received);
}

void loopback_pair_init(struct loopback_pair *pair)
{
	pipe_init(&pair->a_to_b);
	pipe_init(&pair->b_to_a);

	pair->side_a.send = side_a_send;
	pair->side_a.recv = side_a_recv;
	pair->side_a.connected = NULL; /* loopback never disconnects */
	pair->side_a.priv = pair;

	pair->side_b.send = side_b_send;
	pair->side_b.recv = side_b_recv;
	pair->side_b.connected = NULL;
	pair->side_b.priv = pair;
}

void loopback_stage_rx(struct loopback_pipe *p, const uint8_t *data, size_t len)
{
	(void)pipe_write(p, data, len);
}

size_t loopback_drain_tx(struct loopback_pipe *p, uint8_t *out, size_t max_len)
{
	size_t n = 0;
	(void)pipe_read_nonblock(p, out, max_len, &n);
	return n;
}

size_t loopback_pending(struct loopback_pipe *p)
{
	k_mutex_lock(&p->lock, K_FOREVER);
	size_t avail = p->tail - p->head;
	k_mutex_unlock(&p->lock);
	return avail;
}
```

## src/loopback.h
```c
/* SPDX-License-Identifier: GPL-3.0-or-later */
/* See LICENSE at the repo root. */

#pragma once

#include <stdint.h>
#include <stddef.h>
#include <zephyr/kernel.h>

#include "transport/transport.h"

/*
 * In-memory loopback transport pair used to drive session.c on native_sim.
 *
 * Two pipes (A→B, B→A), each backed by a fixed-size byte buffer protected by
 * a mutex + semaphore.  send() copies bytes into the peer's inbox and posts
 * the sem; recv() drains whatever is currently buffered and blocks on the sem
 * when the inbox is empty.  This matches the contract session.c expects from
 * a real transport (recv may return short, including 0 with a spin from
 * raw_recv_exact while waiting for more bytes).
 *
 * The pair supports two driving styles:
 *   - Pre-staged: caller fills a pipe via loopback_stage_rx() before invoking
 *     session.c, then reads the responder's output via loopback_drain_tx().
 *     No second thread needed.  Used by the vector-replay tests.
 *   - Live duplex: a peer thread runs the initiator concurrently with the
 *     responder.  Used by the round-trip test.
 */

#define LOOPBACK_BUF_LEN 4096

struct loopback_pipe {
	uint8_t buf[LOOPBACK_BUF_LEN];
	size_t head;
	size_t tail;
	struct k_mutex lock;
	struct k_sem data_avail;
};

struct loopback_pair {
	struct loopback_pipe a_to_b;
	struct loopback_pipe b_to_a;
	cantil_transport_t side_a; /* writes a_to_b, reads b_to_a */
	cantil_transport_t side_b; /* writes b_to_a, reads a_to_b */
};

void loopback_pair_init(struct loopback_pair *pair);

/* Pre-staged helpers — operate on either pipe directly. */
void loopback_stage_rx(struct loopback_pipe *p, const uint8_t *data, size_t len);
size_t loopback_drain_tx(struct loopback_pipe *p, uint8_t *out, size_t max_len);
size_t loopback_pending(struct loopback_pipe *p);
```

## src/main_cacophony.c
```c
/* SPDX-License-Identifier: GPL-3.0-or-later */
/* See LICENSE at the repo root. */

/*
 * Cacophony-vector entry: drives session.c against xx_vector_cacophony.h,
 * which uses the keypairs from the published Cacophony reference vector
 * for Noise_XX_25519_ChaChaPoly_SHA256.  The published vector's prologue
 * and per-handshake payloads can't be driven through session.c directly
 * (session.c uses empty prologue + empty payloads), so the vector header
 * is re-derived with session.c's wire format using primitives that have
 * been independently validated against the full Cacophony trace — see
 * gen_cacophony_vector.py.
 *
 * Linking against the same loopback / inject / session sources as the
 * primary suite, this gives the full test pipeline a second key set
 * grounded in a published reference.
 */

#include "xx_vector_cacophony.h"

#define SUITE_NAME noise_session_cacophony

#include "noise_session_tests.inc"
```

## src/test_inject.c
```c
/* SPDX-License-Identifier: GPL-3.0-or-later */
/* See LICENSE at the repo root. */

#include <string.h>
#include <errno.h>

#include "session/test_inject.h"
#include "test_inject_ctl.h"

static struct {
	uint8_t s_priv[32], s_pub[32];
	uint8_t e_priv[32], e_pub[32];
	bool armed;
} g_inject;

void test_inject_arm(const uint8_t s_priv[32], const uint8_t s_pub[32], const uint8_t e_priv[32],
		     const uint8_t e_pub[32])
{
	memcpy(g_inject.s_priv, s_priv, 32);
	memcpy(g_inject.s_pub, s_pub, 32);
	memcpy(g_inject.e_priv, e_priv, 32);
	memcpy(g_inject.e_pub, e_pub, 32);
	g_inject.armed = true;
}

void test_inject_disarm(void)
{
	memset(&g_inject, 0, sizeof(g_inject));
}

int cantil_test_inject_static_keypair(uint8_t priv[32], uint8_t pub[32])
{
	if (!g_inject.armed) {
		return -EFAULT;
	}
	memcpy(priv, g_inject.s_priv, 32);
	memcpy(pub, g_inject.s_pub, 32);
	return 0;
}

int cantil_test_inject_ephemeral_keypair(uint8_t priv[32], uint8_t pub[32])
{
	if (!g_inject.armed) {
		return -EFAULT;
	}
	memcpy(priv, g_inject.e_priv, 32);
	memcpy(pub, g_inject.e_pub, 32);
	return 0;
}

/*
 * This vector suite exercises the bare Noise_XX math with empty handshake
 * payloads (matching the precomputed trace), so the responder sends no
 * identity chain.
 */
int cantil_test_inject_local_chain(const uint8_t *certs[], size_t lens[], size_t max)
{
	(void)certs;
	(void)lens;
	(void)max;
	return 0;
}
```

## src/test_inject_ctl.h
```c
/* SPDX-License-Identifier: GPL-3.0-or-later */
/* See LICENSE at the repo root. */

#pragma once

#include <stdint.h>
#include <stdbool.h>

void test_inject_arm(const uint8_t s_priv[32], const uint8_t s_pub[32], const uint8_t e_priv[32],
		     const uint8_t e_pub[32]);
void test_inject_disarm(void);
```

## src/xx_vector.h
```c
/* SPDX-License-Identifier: GPL-3.0-or-later */
/* GENERATED by firmware/tests/noise_session/gen_xx_vector.py — do not edit. */

#pragma once

#include <stdint.h>

/* Noise_XX_25519_ChaChaPoly_SHA256 — deterministic trace from fixed keys.
 * Initiator and responder static + ephemeral private keys are constants;
 * the script derives the resulting wire bytes and post-handshake transport
 * ciphertexts.  Empty prologue, empty handshake-message payloads — matches
 * session.c's wire format. */

static const uint8_t XX_IS_PRIV[32] = {
	0x11, 0x11, 0x11, 0x11, 0x11, 0x11, 0x11, 0x11, 0x11, 0x11, 0x11,
	0x11, 0x11, 0x11, 0x11, 0x11, 0x11, 0x11, 0x11, 0x11, 0x11, 0x11,
	0x11, 0x11, 0x11, 0x11, 0x11, 0x11, 0x11, 0x11, 0x11, 0x11,
};

static const uint8_t XX_IS_PUB[32] = {
	0x7b, 0x4e, 0x90, 0x9b, 0xbe, 0x7f, 0xfe, 0x44, 0xc4, 0x65, 0xa2,
	0x20, 0x03, 0x7d, 0x60, 0x8e, 0xe3, 0x58, 0x97, 0xd3, 0x1e, 0xf9,
	0x72, 0xf0, 0x7f, 0x74, 0x89, 0x2c, 0xb0, 0xf7, 0x3f, 0x13,
};

static const uint8_t XX_IE_PRIV[32] = {
	0x22, 0x22, 0x22, 0x22, 0x22, 0x22, 0x22, 0x22, 0x22, 0x22, 0x22,
	0x22, 0x22, 0x22, 0x22, 0x22, 0x22, 0x22, 0x22, 0x22, 0x22, 0x22,
	0x22, 0x22, 0x22, 0x22, 0x22, 0x22, 0x22, 0x22, 0x22, 0x22,
};

static const uint8_t XX_IE_PUB[32] = {
	0x0f, 0xaa, 0x68, 0x4e, 0xd2, 0x88, 0x67, 0xb9, 0x7f, 0x4a, 0x6a,
	0x2d, 0xee, 0x5d, 0xf8, 0xce, 0x97, 0x4e, 0x76, 0xb7, 0x01, 0x8e,
	0x3f, 0x22, 0xa1, 0xc4, 0xcf, 0x26, 0x78, 0x57, 0x0f, 0x20,
};

static const uint8_t XX_RS_PRIV[32] = {
	0x33, 0x33, 0x33, 0x33, 0x33, 0x33, 0x33, 0x33, 0x33, 0x33, 0x33,
	0x33, 0x33, 0x33, 0x33, 0x33, 0x33, 0x33, 0x33, 0x33, 0x33, 0x33,
	0x33, 0x33, 0x33, 0x33, 0x33, 0x33, 0x33, 0x33, 0x33, 0x33,
};

static const uint8_t XX_RS_PUB[32] = {
	0x7b, 0x0d, 0x47, 0xd9, 0x34, 0x27, 0xf8, 0x31, 0x11, 0x60, 0x78,
	0x1c, 0x7c, 0x73, 0x3f, 0xd8, 0x9f, 0x88, 0x97, 0x0a, 0xef, 0x49,
	0x0d, 0x8a, 0xa0, 0xee, 0x19, 0xa4, 0xcb, 0x8a, 0x1b, 0x14,
};

static const uint8_t XX_RE_PRIV[32] = {
	0x44, 0x44, 0x44, 0x44, 0x44, 0x44, 0x44, 0x44, 0x44, 0x44, 0x44,
	0x44, 0x44, 0x44, 0x44, 0x44, 0x44, 0x44, 0x44, 0x44, 0x44, 0x44,
	0x44, 0x44, 0x44, 0x44, 0x44, 0x44, 0x44, 0x44, 0x44, 0x44,
};

static const uint8_t XX_RE_PUB[32] = {
	0xff, 0x2e, 0xe4, 0x56, 0x01, 0xec, 0x1b, 0x67, 0x31, 0x0c, 0x77,
	0x90, 0x40, 0x45, 0x85, 0xae, 0x69, 0x73, 0x31, 0xee, 0xe1, 0xc1,
	0xf8, 0xcf, 0x24, 0x19, 0x73, 0x1c, 0x1f, 0xff, 0x3e, 0x6b,
};

static const uint8_t XX_MSG1[32] = {
	0x0f, 0xaa, 0x68, 0x4e, 0xd2, 0x88, 0x67, 0xb9, 0x7f, 0x4a, 0x6a,
	0x2d, 0xee, 0x5d, 0xf8, 0xce, 0x97, 0x4e, 0x76, 0xb7, 0x01, 0x8e,
	0x3f, 0x22, 0xa1, 0xc4, 0xcf, 0x26, 0x78, 0x57, 0x0f, 0x20,
};

static const uint8_t XX_MSG2[96] = {
	0xff, 0x2e, 0xe4, 0x56, 0x01, 0xec, 0x1b, 0x67, 0x31, 0x0c, 0x77, 0x90, 0x40, 0x45,
	0x85, 0xae, 0x69, 0x73, 0x31, 0xee, 0xe1, 0xc1, 0xf8, 0xcf, 0x24, 0x19, 0x73, 0x1c,
	0x1f, 0xff, 0x3e, 0x6b, 0x5c, 0xda, 0x1c, 0x2d, 0x80, 0x29, 0x87, 0x7d, 0x73, 0xfa,
	0xd6, 0x28, 0x23, 0x94, 0x6c, 0xcd, 0x0c, 0x5d, 0xa3, 0x5c, 0x12, 0x91, 0x00, 0xf4,
	0x3d, 0x33, 0xa5, 0x9c, 0xf1, 0x9e, 0xa8, 0xfc, 0xdc, 0xc0, 0xe3, 0xe5, 0x7a, 0x60,
	0x99, 0xef, 0x8d, 0x8c, 0x47, 0x16, 0x33, 0x44, 0x28, 0x10, 0xa9, 0x9e, 0xdb, 0x7d,
	0xa3, 0xca, 0x51, 0x6b, 0x03, 0x8e, 0xd0, 0x15, 0x6b, 0x45, 0x0a, 0xa1,
};

static const uint8_t XX_MSG3[64] = {
	0xf4, 0xe4, 0x98, 0x8e, 0x97, 0xbd, 0xcb, 0xf0, 0xf7, 0x99, 0xd0, 0x2d, 0xd2,
	0x24, 0x26, 0x24, 0xbd, 0xa7, 0x2d, 0x20, 0x0e, 0x97, 0xe3, 0x22, 0xc4, 0xf7,
	0x23, 0x21, 0x38, 0x96, 0xa3, 0x1e, 0xb2, 0x9e, 0x17, 0xe6, 0x91, 0x5b, 0xc0,
	0x6d, 0xe3, 0xd6, 0x77, 0x46, 0xda, 0x53, 0x95, 0xfe, 0x08, 0xbd, 0x71, 0x94,
	0xf8, 0xe6, 0x1f, 0x2e, 0xca, 0x7b, 0x0d, 0xe2, 0xe0, 0xdf, 0xa8, 0x7d,
};

static const uint8_t XX_HANDSHAKE_HASH[32] = {
	0x0e, 0x84, 0x37, 0xc2, 0xe8, 0x2d, 0xef, 0x6d, 0xed, 0x29, 0xeb,
	0x65, 0x66, 0x3d, 0xc6, 0xe0, 0x25, 0x71, 0x6a, 0xca, 0x43, 0xa1,
	0x6a, 0x2a, 0x8a, 0x8a, 0x8f, 0x1d, 0x42, 0x1c, 0x64, 0xd4,
};

static const uint8_t XX_INITIATOR_TX_KEY[32] = {
	0x14, 0x13, 0x99, 0xb1, 0x49, 0x03, 0x4c, 0x67, 0x1c, 0xc5, 0x2b,
	0x0e, 0xc1, 0xfc, 0xb7, 0x12, 0x62, 0xd7, 0xad, 0x66, 0x90, 0x8d,
	0x69, 0x3b, 0xeb, 0xe6, 0x1b, 0x7b, 0x96, 0x34, 0x4a, 0x35,
};

static const uint8_t XX_RESPONDER_TX_KEY[32] = {
	0x60, 0x52, 0x7c, 0xc7, 0xe2, 0xd7, 0x9c, 0xda, 0xdd, 0xd5, 0x16,
	0x60, 0x08, 0x5b, 0x84, 0x3c, 0xcd, 0x6f, 0x6c, 0x53, 0x94, 0x7f,
	0xc6, 0xc3, 0xcf, 0x13, 0xa1, 0x1b, 0x0e, 0xb9, 0xaf, 0x74,
};

static const uint8_t XX_MSG_A_PT[20] = {
	0x68, 0x65, 0x6c, 0x6c, 0x6f, 0x20, 0x66, 0x72, 0x6f, 0x6d,
	0x20, 0x69, 0x6e, 0x69, 0x74, 0x69, 0x61, 0x74, 0x6f, 0x72,
};

static const uint8_t XX_MSG_A_CT[36] = {
	0x4f, 0x23, 0xd4, 0xcc, 0xee, 0x5b, 0xb7, 0xe5, 0x2b, 0x8e, 0xff, 0xde,
	0xb2, 0x4b, 0x7a, 0x6b, 0xf7, 0xdd, 0xd4, 0xee, 0xca, 0x70, 0x97, 0x81,
	0x97, 0x42, 0x78, 0x77, 0xfd, 0x78, 0x89, 0x73, 0xba, 0x68, 0x22, 0xb6,
};

static const uint8_t XX_MSG_B_PT[20] = {
	0x68, 0x65, 0x6c, 0x6c, 0x6f, 0x20, 0x66, 0x72, 0x6f, 0x6d,
	0x20, 0x72, 0x65, 0x73, 0x70, 0x6f, 0x6e, 0x64, 0x65, 0x72,
};

static const uint8_t XX_MSG_B_CT[36] = {
	0x10, 0xfb, 0x60, 0x24, 0xc5, 0xc6, 0x4a, 0xe8, 0xdf, 0x3c, 0x69, 0xe5,
	0x5f, 0x90, 0x9c, 0x29, 0x07, 0x1e, 0x75, 0xa9, 0xcf, 0xb8, 0x3e, 0xa8,
	0x89, 0x73, 0x30, 0x8b, 0x5b, 0x81, 0xf6, 0xe8, 0x1d, 0xad, 0x88, 0x94,
};
```

## src/xx_vector_cacophony.h
```c
/* SPDX-License-Identifier: GPL-3.0-or-later */
/* GENERATED by firmware/tests/noise_session/gen_cacophony_vector.py — do not edit. */

#pragma once

#include <stdint.h>

/* Noise_XX_25519_ChaChaPoly_SHA256 trace using the Cacophony reference
 * vector's keypairs (init_static, init_ephemeral, resp_static,
 * resp_ephemeral from vectors/cacophony_xx_25519_chachapoly_sha256.json).
 *
 * The published Cacophony entry uses a non-empty prologue and payloads
 * in every handshake message; session.c does neither.  We therefore
 * re-derive the trace with the Cacophony keys but session.c's wire
 * format (empty prologue, empty handshake payloads).  The spec
 * primitives are validated against Cacophony separately — see the
 * keystone check in gen_cacophony_vector.py:validate_against_cacophony.
 */

static const uint8_t XX_IS_PRIV[32] = {
	0xe6, 0x1e, 0xf9, 0x91, 0x9c, 0xde, 0x45, 0xdd, 0x5f, 0x82, 0x16,
	0x64, 0x04, 0xbd, 0x08, 0xe3, 0x8b, 0xce, 0xb5, 0xdf, 0xdf, 0xde,
	0xd0, 0xa3, 0x4c, 0x8d, 0xf7, 0xed, 0x54, 0x22, 0x14, 0xd1,
};

static const uint8_t XX_IS_PUB[32] = {
	0x6b, 0xc3, 0x82, 0x2a, 0x2a, 0xa7, 0xf4, 0xe6, 0x98, 0x1d, 0x65,
	0x38, 0x69, 0x2b, 0x3c, 0xdf, 0x3e, 0x6d, 0xf9, 0xee, 0xa6, 0xed,
	0x26, 0x9e, 0xb4, 0x1d, 0x93, 0xc2, 0x27, 0x57, 0xb7, 0x5a,
};

static const uint8_t XX_IE_PRIV[32] = {
	0x89, 0x3e, 0x28, 0xb9, 0xdc, 0x6c, 0xa8, 0xd6, 0x11, 0xab, 0x66,
	0x47, 0x54, 0xb8, 0xce, 0xb7, 0xba, 0xc5, 0x11, 0x73, 0x49, 0xa4,
	0x43, 0x9a, 0x6b, 0x05, 0x69, 0xda, 0x97, 0x7c, 0x46, 0x4a,
};

static const uint8_t XX_IE_PUB[32] = {
	0xca, 0x35, 0xde, 0xf5, 0xae, 0x56, 0xce, 0xc3, 0x3d, 0xc2, 0x03,
	0x67, 0x31, 0xab, 0x14, 0x89, 0x6b, 0xc4, 0xc7, 0x5d, 0xbb, 0x07,
	0xa6, 0x1f, 0x87, 0x9f, 0x8e, 0x3a, 0xfa, 0x4c, 0x79, 0x44,
};

static const uint8_t XX_RS_PRIV[32] = {
	0x4a, 0x3a, 0xcb, 0xfd, 0xb1, 0x63, 0xde, 0xc6, 0x51, 0xdf, 0xa3,
	0x19, 0x4d, 0xec, 0xe6, 0x76, 0xd4, 0x37, 0x02, 0x9c, 0x62, 0xa4,
	0x08, 0xb4, 0xc5, 0xea, 0x91, 0x14, 0x24, 0x6e, 0x48, 0x93,
};

static const uint8_t XX_RS_PUB[32] = {
	0x31, 0xe0, 0x30, 0x3f, 0xd6, 0x41, 0x8d, 0x2f, 0x8c, 0x0e, 0x78,
	0xb9, 0x1f, 0x22, 0xe8, 0xca, 0xed, 0x0f, 0xbe, 0x48, 0x65, 0x6d,
	0xcf, 0x47, 0x67, 0xe4, 0x83, 0x4f, 0x70, 0x1b, 0x8f, 0x62,
};

static const uint8_t XX_RE_PRIV[32] = {
	0xbb, 0xdb, 0x4c, 0xdb, 0xd3, 0x09, 0xf1, 0xa1, 0xf2, 0xe1, 0x45,
	0x69, 0x67, 0xfe, 0x28, 0x8c, 0xad, 0xd6, 0xf7, 0x12, 0xd6, 0x5d,
	0xc7, 0xb7, 0x79, 0x3d, 0x5e, 0x63, 0xda, 0x6b, 0x37, 0x5b,
};

static const uint8_t XX_RE_PUB[32] = {
	0x95, 0xeb, 0xc6, 0x0d, 0x2b, 0x1f, 0xa6, 0x72, 0xc1, 0xf4, 0x6a,
	0x8a, 0xa2, 0x65, 0xef, 0x51, 0xbf, 0xe3, 0x8e, 0x7c, 0xcb, 0x39,
	0xec, 0x5b, 0xe3, 0x40, 0x69, 0xf1, 0x44, 0x80, 0x88, 0x43,
};

static const uint8_t XX_MSG1[32] = {
	0xca, 0x35, 0xde, 0xf5, 0xae, 0x56, 0xce, 0xc3, 0x3d, 0xc2, 0x03,
	0x67, 0x31, 0xab, 0x14, 0x89, 0x6b, 0xc4, 0xc7, 0x5d, 0xbb, 0x07,
	0xa6, 0x1f, 0x87, 0x9f, 0x8e, 0x3a, 0xfa, 0x4c, 0x79, 0x44,
};

static const uint8_t XX_MSG2[96] = {
	0x95, 0xeb, 0xc6, 0x0d, 0x2b, 0x1f, 0xa6, 0x72, 0xc1, 0xf4, 0x6a, 0x8a, 0xa2, 0x65,
	0xef, 0x51, 0xbf, 0xe3, 0x8e, 0x7c, 0xcb, 0x39, 0xec, 0x5b, 0xe3, 0x40, 0x69, 0xf1,
	0x44, 0x80, 0x88, 0x43, 0x81, 0xcb, 0xad, 0x1f, 0x27, 0x6e, 0x03, 0x8c, 0x48, 0x37,
	0x8f, 0xfc, 0xe2, 0xb6, 0x52, 0x85, 0xe0, 0x8d, 0x6b, 0x68, 0xaa, 0xa3, 0x62, 0x9a,
	0x5a, 0x86, 0x39, 0x39, 0x24, 0x90, 0xe5, 0xb9, 0x0b, 0x20, 0xf0, 0x24, 0xc6, 0xab,
	0xdc, 0x05, 0xd6, 0x18, 0xc6, 0x1c, 0x13, 0xa3, 0xfe, 0x07, 0x2c, 0xc5, 0x8d, 0xff,
	0xf9, 0xbc, 0xf8, 0x2e, 0x0a, 0x1b, 0xfd, 0xb6, 0x07, 0x21, 0xdb, 0x50,
};

static const uint8_t XX_MSG3[64] = {
	0xc7, 0x19, 0x5f, 0xfa, 0xca, 0xc1, 0x30, 0x7f, 0xf9, 0x90, 0x46, 0xf2, 0x19,
	0x75, 0x0f, 0xc4, 0x76, 0x93, 0xe2, 0x3c, 0x3c, 0xb0, 0x8b, 0x89, 0xc2, 0xaf,
	0x80, 0x8b, 0x44, 0x48, 0x50, 0xa8, 0x88, 0xf4, 0x16, 0x2c, 0x55, 0x6c, 0x15,
	0x76, 0xdb, 0xe5, 0xa5, 0x26, 0x1e, 0x23, 0x23, 0xd7, 0x58, 0x30, 0x42, 0x60,
	0xa0, 0xcc, 0xff, 0x3e, 0x10, 0x8f, 0x87, 0x5a, 0x8c, 0xb4, 0xb3, 0x63,
};

static const uint8_t XX_HANDSHAKE_HASH[32] = {
	0x54, 0xe5, 0x0e, 0xd4, 0x9e, 0x16, 0xbf, 0x78, 0xf6, 0xd6, 0x38,
	0x27, 0x1c, 0x44, 0x14, 0x39, 0x44, 0xb3, 0x87, 0x07, 0x3b, 0xe9,
	0x35, 0xab, 0x63, 0x91, 0x5c, 0x16, 0x70, 0x7e, 0x93, 0x39,
};

static const uint8_t XX_INITIATOR_TX_KEY[32] = {
	0x30, 0x62, 0xff, 0xf0, 0x68, 0xd0, 0xab, 0xd1, 0x71, 0xb4, 0xb4,
	0x60, 0x3c, 0x5b, 0x76, 0x33, 0xbf, 0x5e, 0xe4, 0xe7, 0x9d, 0xa3,
	0x11, 0x37, 0x0c, 0x2e, 0xba, 0x7f, 0x1e, 0xd6, 0xc6, 0x9a,
};

static const uint8_t XX_RESPONDER_TX_KEY[32] = {
	0xcb, 0xab, 0xb3, 0xf5, 0xe4, 0x52, 0x9f, 0xc0, 0xe9, 0x3e, 0xfd,
	0xa9, 0xb4, 0xb7, 0x01, 0x69, 0x27, 0x0c, 0x04, 0xb0, 0x5c, 0x5b,
	0xe2, 0x5f, 0x71, 0xe9, 0xc5, 0x5f, 0x79, 0x55, 0xc8, 0x6a,
};

static const uint8_t XX_MSG_A_PT[20] = {
	0x68, 0x65, 0x6c, 0x6c, 0x6f, 0x20, 0x66, 0x72, 0x6f, 0x6d,
	0x20, 0x69, 0x6e, 0x69, 0x74, 0x69, 0x61, 0x74, 0x6f, 0x72,
};

static const uint8_t XX_MSG_A_CT[36] = {
	0x1c, 0x40, 0xfc, 0x5d, 0x2d, 0x58, 0x41, 0xac, 0x5f, 0x6f, 0x76, 0x26,
	0xf3, 0xf8, 0xfe, 0xf7, 0xae, 0x92, 0xe1, 0x05, 0x59, 0xbe, 0x87, 0x10,
	0xf7, 0x27, 0x28, 0x94, 0x78, 0x35, 0xea, 0xe6, 0xbe, 0x7a, 0x02, 0xb8,
};

static const uint8_t XX_MSG_B_PT[20] = {
	0x68, 0x65, 0x6c, 0x6c, 0x6f, 0x20, 0x66, 0x72, 0x6f, 0x6d,
	0x20, 0x72, 0x65, 0x73, 0x70, 0x6f, 0x6e, 0x64, 0x65, 0x72,
};

static const uint8_t XX_MSG_B_CT[36] = {
	0xbd, 0x72, 0x20, 0xd7, 0x3c, 0x95, 0xe7, 0x67, 0xbb, 0x79, 0x7d, 0x46,
	0x6c, 0x41, 0x8e, 0x90, 0x30, 0x7e, 0xf0, 0xa9, 0x03, 0x4c, 0xbf, 0xed,
	0x32, 0x1c, 0x55, 0x80, 0x3d, 0x97, 0xf4, 0x88, 0xb0, 0x28, 0x5f, 0x6f,
};
```
