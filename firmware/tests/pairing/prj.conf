## CMakeLists.txt
```
# SPDX-License-Identifier: GPL-3.0-or-later
#
# Pairing gate conformance on native_sim (transport + pairing T-16).
# Exercises pairing.c + client_bond.c + storage.c on a simulated LittleFS
# partition, with PAIRING_TOFU=y selected via prj.conf.
#
# Build:
#   ZEPHYR_TOOLCHAIN_VARIANT=host \
#     west build -p -b native_sim firmware/tests/pairing --no-sysbuild
#   west build -t run

cmake_minimum_required(VERSION 3.20.0)

find_package(Zephyr REQUIRED HINTS $ENV{ZEPHYR_BASE})
project(pairing_tests LANGUAGES C)

set(FW ${CMAKE_CURRENT_SOURCE_DIR}/../..)

target_sources(app PRIVATE
    src/main.c
    src/gesture_stub.c
    ${FW}/src/clients/pairing.c
    ${FW}/src/clients/client_bond.c
    ${FW}/src/storage/storage.c
    ${FW}/src/storage/volume_marker.c
    ${FW}/src/crypto/device_id.c
    ${FW}/src/crypto/crypto_wolfssl.c
    ${FW}/src/crypto/wc_rand.c
    ${FW}/src/crypto/zeroize.c
    ${FW}/../common/cbor/cantil_cbor.c
)

target_include_directories(app PRIVATE
    ${FW}/src
    ${FW}/include
    ${FW}/../common/cbor
)

zephyr_include_directories(${FW}/include)

# Carries WOLFSSL_USER_SETTINGS / WOLFSSL_ZEPHYR defines.
target_link_libraries(app PRIVATE wolfSSL)
```

## Kconfig
```
# SPDX-License-Identifier: GPL-3.0-or-later

mainmenu "pairing ztest"

config CANTIL_MAX_KEY_SLOTS
	int "Maximum number of key slots"
	default 8
	range 1 64

config CANTIL_MAX_CLIENT_BONDS
	int "Maximum number of host-client bonds"
	default 2
	range 1 16

config CANTIL_MAX_PEER_BONDS
	int "Maximum number of peer-device bonds"
	default 2
	range 1 8

config CANTIL_CRL_VALIDITY_SEC
	int "CRL nextUpdate window (seconds)"
	default 86400

# Pairing method symbols (flat booleans — no choice wrapper in test context).
config PAIRING_PROMISCUOUS
	bool "Method 0 — Promiscuous"
	default n

config PAIRING_TOFU
	bool "Method 1 — Silent TOFU"
	default n

config PAIRING_TAP_CONFIRM
	bool "Method 2 — Tap-confirmed bond"
	default n

config PAIRING_PASSKEY
	bool "Method 3 — Passkey + tap-confirmed bond"
	default n

config CANTIL_PAIR_TIMEOUT_SEC
	int "Pairing prompt timeout (seconds)"
	default 30

source "Kconfig.zephyr"
```

## prj.conf
```kconfig
# ztest framework
CONFIG_ZTEST=y

# Pairing method under test.
CONFIG_PAIRING_TAP_CONFIRM=y
CONFIG_CANTIL_PAIR_TIMEOUT_SEC=30

CONFIG_CANTIL_MAX_CLIENT_BONDS=2
CONFIG_CANTIL_MAX_PEER_BONDS=2

# Entropy — native_sim has zephyr,native-posix-rng.
CONFIG_ENTROPY_GENERATOR=y
CONFIG_TEST_RANDOM_GENERATOR=y

# LittleFS on the sim flash partition.
CONFIG_FLASH=y
CONFIG_FLASH_MAP=y
CONFIG_FILE_SYSTEM=y
CONFIG_FILE_SYSTEM_LITTLEFS=y
CONFIG_FS_LITTLEFS_FMP_DEV=y
CONFIG_FILE_SYSTEM_MKFS=y


# Device-id source for the FICR-derived storage key.
CONFIG_HWINFO=y

CONFIG_MAIN_STACK_SIZE=8192
CONFIG_HEAP_MEM_POOL_SIZE=16384

# crc32_ieee — storage.c volume identity marker
CONFIG_CRC=y

# wolfCrypt — primitives selected by the settings header, not Kconfig.
CONFIG_WOLFSSL=y
CONFIG_WOLFSSL_BUILTIN=y
CONFIG_WOLFSSL_SETTINGS_FILE="cantil_wolfssl_user_settings.h"
```

## src/main.c
```c
/* SPDX-License-Identifier: GPL-3.0-or-later */
/* See LICENSE at the repo root. */

/*
 * Pairing gate conformance on native_sim (transport + pairing T-16/T-17).
 *
 * Drives pairing.c + client_bond.c + storage.c against the simulated flash
 * partition.  Each test starts from a wiped /clients/ dir via before() so
 * order-independence holds.
 *
 * Method under test: PAIRING_TAP_CONFIRM (Method 2).
 * The gesture layer is stubbed in gesture_stub.c; tests control the outcome
 * via pairing_test_set_gesture_result().
 *
 * Coverage:
 *   1. Known bond → allowed immediately, no gesture prompt.
 *   2. Unknown client, user taps confirm → bonded, returns 0.
 *   3. Unknown client, user taps wrong sequence (DENIED) → -EACCES, not bonded.
 *   4. Unknown client, timeout → -EACCES, not bonded.
 *   5. Unknown client, cap full → -EACCES without any gesture prompt.
 */

#include <zephyr/kernel.h>
#include <zephyr/ztest.h>
#include <zephyr/fs/fs.h>
#include <string.h>
#include <errno.h>

#include "clients/pairing.h"
#include "clients/client_bond.h"
#include "gesture/gesture.h"
#include "storage/storage.h"

#define LFS_MOUNT   "/lfs"
#define CLIENTS_DIR LFS_MOUNT "/clients"

/* Declared in gesture_stub.c */
void pairing_test_set_gesture_result(cantil_confirm_result_t r);

/* Distinct synthetic Curve25519 pubkeys (first 4 bytes determine storage ID). */
static const uint8_t PUB_A[32] = {0xAA, 0x01, 0x02, 0x03, 0, 0, 0, 0, 0, 0, 0, 0, 0, 0, 0, 0,
				  0,    0,    0,    0,    0, 0, 0, 0, 0, 0, 0, 0, 0, 0, 0, 0};
static const uint8_t PUB_B[32] = {0xBB, 0x01, 0x02, 0x03, 0, 0, 0, 0, 0, 0, 0, 0, 0, 0, 0, 0,
				  0,    0,    0,    0,    0, 0, 0, 0, 0, 0, 0, 0, 0, 0, 0, 0};
static const uint8_t PUB_C[32] = {0xCC, 0x01, 0x02, 0x03, 0, 0, 0, 0, 0, 0, 0, 0, 0, 0, 0, 0,
				  0,    0,    0,    0,    0, 0, 0, 0, 0, 0, 0, 0, 0, 0, 0, 0};

/* ── helpers ────────────────────────────────────────────────────────────── */

static void rm_rf_dir(const char *path)
{
	struct fs_dir_t dir;
	struct fs_dirent ent;
	char child[128];

	fs_dir_t_init(&dir);
	if (fs_opendir(&dir, path) != 0) {
		return;
	}

	while (fs_readdir(&dir, &ent) == 0 && ent.name[0] != '\0') {
		snprintf(child, sizeof(child), "%s/%s", path, ent.name);
		if (ent.type == FS_DIR_ENTRY_DIR) {
			rm_rf_dir(child);
		}
		fs_unlink(child);
	}
	fs_closedir(&dir);
	fs_unlink(path);
}

/* ── suite setup / per-test reset ───────────────────────────────────────── */

static void *suite_setup(void)
{
	zassert_ok(storage_init(), "storage_init failed");

	/*
	 * A fresh volume has no identity marker, and client_bond_add() refuses
	 * to persist on an unmarked, empty volume — that combination is what a
	 * misdeclared partition looks like. Mark it, exactly as the factory
	 * image does before anything is provisioned. Same idiom as
	 * ca_bootstrap/crl_der/pairing_ca_anchor.
	 *
	 * Without this the suite passes only when it inherits a marked
	 * flash.bin from an earlier run in the same directory, which is not a
	 * property this suite should depend on.
	 */
	(void)storage_volume_marker_write();
	return NULL;
}

static void before(void *unused)
{
	ARG_UNUSED(unused);
	rm_rf_dir(CLIENTS_DIR);
	/* Default gesture result: confirmed. Individual tests override as needed. */
	pairing_test_set_gesture_result(CANTIL_CONFIRM_OK);
}

ZTEST_SUITE(pairing, NULL, suite_setup, before, NULL, NULL);

/* ── test 1: already-bonded client is allowed (no gesture prompt) ─────── */

ZTEST(pairing, test_known_bond_allowed)
{
	/* Pre-bond PUB_A. */
	zassert_ok(client_bond_add(PUB_A, CLIENT_KIND_HOST, 0), "setup: bond_add failed");

	/* pairing_check_and_bond should accept without prompting. */
	zassert_ok(pairing_check_and_bond(PUB_A, NULL), "known client rejected");

	/* Bond count must still be 1 (no duplicate). */
	uint32_t hosts = 0, peers = 0;

	zassert_ok(client_bond_count(&hosts, &peers), "bond_count failed");
	zassert_equal(hosts, 1, "expected 1 host bond, got %u", hosts);
}

/* ── test 2: unknown client, gesture confirmed → bonded ──────────────── */

ZTEST(pairing, test_unknown_client_tap_confirmed)
{
	pairing_test_set_gesture_result(CANTIL_CONFIRM_OK);

	zassert_equal(client_bond_exists(PUB_A), 0, "pre-condition: PUB_A bonded");

	zassert_ok(pairing_check_and_bond(PUB_A, NULL), "tap-confirmed bond failed");

	zassert_equal(client_bond_exists(PUB_A), 1, "bond not persisted after tap-confirm");
}

/* ── test 3: unknown client, gesture denied → rejected, not bonded ────── */

ZTEST(pairing, test_unknown_client_tap_denied)
{
	pairing_test_set_gesture_result(CANTIL_CONFIRM_DENIED);

	int rc = pairing_check_and_bond(PUB_A, NULL);

	zassert_equal(rc, -EACCES, "expected -EACCES on denied gesture, got %d", rc);

	zassert_equal(client_bond_exists(PUB_A), 0, "PUB_A was bonded despite denial");
}

/* ── test 4: unknown client, gesture timeout → rejected, not bonded ───── */

ZTEST(pairing, test_unknown_client_tap_timeout)
{
	pairing_test_set_gesture_result(CANTIL_CONFIRM_TIMEOUT);

	int rc = pairing_check_and_bond(PUB_A, NULL);

	zassert_equal(rc, -EACCES, "expected -EACCES on gesture timeout, got %d", rc);

	zassert_equal(client_bond_exists(PUB_A), 0, "PUB_A was bonded despite timeout");
}

/* ── test 5: cap full → unknown client rejected without gesture ────────── */

ZTEST(pairing, test_cap_full_rejected)
{
	/* Fill to CONFIG_CANTIL_MAX_CLIENT_BONDS (=2 in prj.conf). */
	zassert_ok(client_bond_add(PUB_A, CLIENT_KIND_HOST, 0), "bond A failed");
	zassert_ok(client_bond_add(PUB_B, CLIENT_KIND_HOST, 0), "bond B failed");

	/* Third unknown client must be rejected without prompting. */
	int rc = pairing_check_and_bond(PUB_C, NULL);

	zassert_equal(rc, -EACCES, "expected -EACCES when cap full, got %d", rc);

	zassert_equal(client_bond_exists(PUB_C), 0, "PUB_C was bonded despite cap");
}
```

## src/gesture_stub.c
```c
/* SPDX-License-Identifier: GPL-3.0-or-later */
/* See LICENSE at the repo root. */

/*
 * Gesture stub for the pairing ztest suite (T-17).
 *
 * gesture_request_pair_confirm() is called by pairing.c (PAIRING_TAP_CONFIRM)
 * when an unknown client connects.  In this stub the callback fires
 * synchronously with whatever result pairing_test_set_gesture_result() loaded
 * — no real gesture hardware or work queue needed.
 *
 * The k_sem_give() inside the callback is called before gesture_request_pair_
 * confirm() returns, so the k_sem_take() in pairing.c sees count=1 and returns
 * immediately.
 */

#include "gesture/gesture.h"

static cantil_confirm_result_t stub_result = CANTIL_CONFIRM_OK;

void pairing_test_set_gesture_result(cantil_confirm_result_t r)
{
	stub_result = r;
}

int gesture_request_pair_confirm(cantil_confirm_cb_t cb, void *user_data)
{
	cb(stub_result, user_data);
	return 0;
}
```
