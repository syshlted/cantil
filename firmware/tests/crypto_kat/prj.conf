## CMakeLists.txt
```
# SPDX-License-Identifier: GPL-3.0-or-later
#
# Known-answer tests for crypto.h against the wolfCrypt backend
# (src/crypto/crypto_wolfssl.c).
#
# There used to be a second directory here running the same src/main.c against
# the mbedTLS backend, and that cross-check is what made the vectors meaningful
# while two backends existed. It is not what makes them meaningful now: every
# vector in src/vectors.h comes from a third implementation (RFC 6979 §A.2.5,
# RFC 5869 TC1, and Python's hmac/AESGCM), so a pass says wolfCrypt agrees with
# the standard rather than with itself. See gen_vectors.py.
#
# Build + run:
#   ./scripts/test.sh crypto_kat

cmake_minimum_required(VERSION 3.20.0)

find_package(Zephyr REQUIRED HINTS $ENV{ZEPHYR_BASE})
project(crypto_kat_tests LANGUAGES C)

set(FW ${CMAKE_CURRENT_SOURCE_DIR}/../..)

target_sources(app PRIVATE
    src/main.c
    ${FW}/src/crypto/crypto_wolfssl.c
    ${FW}/src/crypto/zeroize.c
    ${FW}/src/crypto/wc_rand.c
    ${FW}/src/crypto/device_id.c
)

target_include_directories(app PRIVATE
    src
    ${FW}/src
    ${FW}/src/crypto
)

# cantil_wolfssl_user_settings.h lives here.
zephyr_include_directories(${FW}/include)

# Carries WOLFSSL_USER_SETTINGS / WOLFSSL_ZEPHYR.
target_link_libraries(app PRIVATE wolfSSL)
```

## prj.conf
```kconfig
# ztest framework
CONFIG_ZTEST=y

# crypto_wolfssl.c draws every random byte from the Zephyr entropy device via
# CUSTOM_RAND_GENERATE_BLOCK; there is no DRBG in between.
CONFIG_ENTROPY_GENERATOR=y
CONFIG_TEST_RANDOM_GENERATOR=y

# wolfCrypt. Which primitives get compiled is decided by the settings header,
# not by Kconfig — see firmware/include/cantil_wolfssl_user_settings.h.
CONFIG_WOLFSSL=y
CONFIG_WOLFSSL_BUILTIN=y
CONFIG_WOLFSSL_SETTINGS_FILE="cantil_wolfssl_user_settings.h"

CONFIG_MAIN_STACK_SIZE=8192
CONFIG_HEAP_MEM_POOL_SIZE=16384
```

## src/main.c
```c
/* SPDX-License-Identifier: GPL-3.0-or-later */
/* See LICENSE at the repo root. */

/*
 * Known-answer tests for crypto.h, run against whichever backend the suite
 * directory links (crypto.c / mbedTLS, or crypto_wolfssl.c / wolfCrypt).
 *
 * Two of these are not ordinary correctness checks but data-availability ones.
 * The CA private key is stored AES-256-GCM encrypted under
 * crypto_storage_key_derive(), cannot be exported, and has no backup. If a
 * backend derived that key differently, or laid the blob out differently, then
 * changing backends would turn a firmware update into unrecoverable key loss —
 * the device would boot, mount its volume, find its key blob intact, and fail
 * to authenticate it. storage_key_derive_kat and decrypt_blob_kat are what
 * stop that reaching a device.
 */

#include <zephyr/kernel.h>
#include <zephyr/ztest.h>
#include <string.h>
#include <errno.h>

#include "crypto.h"
#include "vectors.h"

ZTEST_SUITE(crypto_kat, NULL, NULL, NULL, NULL, NULL);

/* ── storage key ─────────────────────────────────────────────────────── */

ZTEST(crypto_kat, storage_key_derive_kat)
{
	uint8_t key[32];

	zassert_ok(crypto_storage_key_derive(key), "derive");
	zassert_mem_equal(key, KAT_STORAGE_KEY, 32,
			  "storage key differs from HKDF-SHA256(salt=empty, "
			  "ikm=FICR UID, info=\"cantil-storage-key\") — every "
			  "stored key blob becomes undecryptable");
}

ZTEST(crypto_kat, storage_key_derive_is_stable)
{
	uint8_t a[32], b[32];

	zassert_ok(crypto_storage_key_derive(a), "derive a");
	zassert_ok(crypto_storage_key_derive(b), "derive b");
	zassert_mem_equal(a, b, 32, "derivation is not deterministic");
}

/* ── HKDF ────────────────────────────────────────────────────────────── */

/*
 * crypto_hkdf_sha256() is what crypto_storage_key_derive() and the pairing PSK
 * both sit on, so it is pinned against RFC 5869 Test Case 1 — a published
 * answer, which is the only kind that can say two libraries agree without
 * nominating one of them as the oracle.
 */
ZTEST(crypto_kat, hkdf_rfc5869_tc1)
{
	uint8_t okm[42];

	zassert_ok(crypto_hkdf_sha256(KAT_HKDF_IKM, sizeof(KAT_HKDF_IKM), KAT_HKDF_SALT,
				      sizeof(KAT_HKDF_SALT), KAT_HKDF_INFO, sizeof(KAT_HKDF_INFO),
				      okm, sizeof(okm)),
		   "hkdf");
	zassert_mem_equal(okm, KAT_HKDF_OKM, sizeof(okm),
			  "HKDF-SHA256 disagrees with RFC 5869 TC1");
}

/*
 * A NULL salt must mean RFC 5869's "not provided" case, which the standard
 * defines as a hash-length block of zeros — not as an empty HMAC key. The two
 * are different, both libraries happen to implement the former, and
 * crypto_storage_key_derive() depends on it: get this wrong and every stored
 * key blob becomes undecryptable. Assert the equivalence directly rather than
 * trusting that both libraries kept it.
 */
ZTEST(crypto_kat, hkdf_null_salt_is_a_zero_block)
{
	const uint8_t zeros[32] = {0};
	uint8_t a[32], b[32];

	zassert_ok(crypto_hkdf_sha256(KAT_HKDF_IKM, sizeof(KAT_HKDF_IKM), NULL, 0, KAT_HKDF_INFO,
				      sizeof(KAT_HKDF_INFO), a, sizeof(a)),
		   "null salt");
	zassert_ok(crypto_hkdf_sha256(KAT_HKDF_IKM, sizeof(KAT_HKDF_IKM), zeros, sizeof(zeros),
				      KAT_HKDF_INFO, sizeof(KAT_HKDF_INFO), b, sizeof(b)),
		   "explicit zero salt");
	zassert_mem_equal(a, b, sizeof(a),
			  "NULL salt is not being treated as a 32-byte zero block");
}

/*
 * The pairing PSK, as src/clients/pairing.c derive_psk() computes it. That
 * function is static, so the inputs are reproduced here rather than called;
 * what is being pinned is the seam's answer for them.
 *
 * Worth a fixed answer because the failure is silent: the two peers derive
 * this independently, so a backend that disagreed would not report an error —
 * pairing would simply never complete, with nothing on either side saying why.
 */
ZTEST(crypto_kat, pairing_psk_kat)
{
	const uint8_t ikm[4] = {(uint8_t)(KAT_PSK_PASSKEY >> 24), (uint8_t)(KAT_PSK_PASSKEY >> 16),
				(uint8_t)(KAT_PSK_PASSKEY >> 8), (uint8_t)(KAT_PSK_PASSKEY)};
	uint8_t salt[64];
	uint8_t psk[32];
	static const uint8_t info[] = "cantil-psk-v1";

	memcpy(salt, KAT_PSK_LOCAL, 32);
	memcpy(salt + 32, KAT_PSK_REMOTE, 32);

	zassert_ok(crypto_hkdf_sha256(ikm, sizeof(ikm), salt, sizeof(salt), info, sizeof(info) - 1,
				      psk, sizeof(psk)),
		   "derive psk");
	zassert_mem_equal(psk, KAT_PSK, sizeof(psk),
			  "pairing PSK differs — passkey pairing would fail "
			  "silently against a peer on the other backend");
}

/* ── P-256 ───────────────────────────────────────────────────────────── */

ZTEST(crypto_kat, pubkey_from_privkey_kat)
{
	uint8_t pub[65];
	size_t len = sizeof(pub);

	zassert_ok(crypto_pubkey_from_privkey(KAT_P256_PRIV, 32, pub, &len), "pubkey");
	zassert_equal(len, 65, "expected uncompressed SEC1, got %zu", len);
	zassert_mem_equal(pub, KAT_P256_PUB, 65, "pubkey mismatch");
}

ZTEST(crypto_kat, sign_deterministic_kat)
{
	/*
	 * RFC 6979 §A.2.5. A signature that matches this proves the backend
	 * derives k the same way, which is what makes two backends produce
	 * byte-identical certificates from the same CA key — and what stops a
	 * biased or repeated k leaking a key that can never be rotated.
	 */
	uint8_t sig[64];
	size_t len = sizeof(sig);

	zassert_ok(crypto_sign(KAT_P256_PRIV, 32, KAT_P256_DIGEST, 32, sig, &len), "sign");
	zassert_equal(len, 64, "expected raw r||s, got %zu", len);
	zassert_mem_equal(sig, KAT_P256_SIG, 64, "signature differs from RFC 6979 A.2.5");
}

ZTEST(crypto_kat, sign_repeats_exactly)
{
	uint8_t a[64], b[64];
	size_t la = sizeof(a), lb = sizeof(b);

	zassert_ok(crypto_sign(KAT_P256_PRIV, 32, KAT_P256_DIGEST, 32, a, &la), "sign a");
	zassert_ok(crypto_sign(KAT_P256_PRIV, 32, KAT_P256_DIGEST, 32, b, &lb), "sign b");
	zassert_mem_equal(a, b, 64, "signing is not deterministic");
}

ZTEST(crypto_kat, keygen_produces_a_usable_key)
{
	uint8_t priv[32];
	size_t plen = sizeof(priv);
	uint8_t pub[65];
	size_t publen = sizeof(pub);

	zassert_ok(crypto_keygen(priv, &plen), "keygen");
	zassert_equal(plen, 32, "expected a 32-byte scalar, got %zu", plen);

	zassert_ok(crypto_pubkey_from_privkey(priv, plen, pub, &publen),
		   "pubkey from generated key");
	zassert_equal(publen, 65, "expected uncompressed SEC1");
	zassert_equal(pub[0], 0x04, "expected the uncompressed point tag");

	uint8_t sig[64];
	size_t siglen = sizeof(sig);

	zassert_ok(crypto_sign(priv, plen, KAT_P256_DIGEST, 32, sig, &siglen),
		   "sign with generated key");
}

/* ── AES-256-GCM key blobs ───────────────────────────────────────────── */

ZTEST(crypto_kat, decrypt_blob_kat)
{
	uint8_t pt[64];
	size_t len = sizeof(pt);

	zassert_ok(crypto_decrypt_blob(KAT_BLOB_KEY, KAT_BLOB, sizeof(KAT_BLOB), pt, &len),
		   "decrypt");
	zassert_equal(len, sizeof(KAT_BLOB_PT), "length %zu", len);
	zassert_mem_equal(pt, KAT_BLOB_PT, sizeof(KAT_BLOB_PT),
			  "blob layout or cipher differs — stored key blobs "
			  "written by another backend would not read back");
}

ZTEST(crypto_kat, encrypt_decrypt_roundtrip)
{
	uint8_t ct[128];
	size_t ctlen = sizeof(ct);
	uint8_t pt[64];
	size_t ptlen = sizeof(pt);

	zassert_ok(crypto_encrypt_blob(KAT_BLOB_KEY, KAT_BLOB_PT, sizeof(KAT_BLOB_PT), ct, &ctlen),
		   "encrypt");
	zassert_equal(ctlen, 12 + sizeof(KAT_BLOB_PT) + 16, "expected [nonce][ct][tag], got %zu",
		      ctlen);

	zassert_ok(crypto_decrypt_blob(KAT_BLOB_KEY, ct, ctlen, pt, &ptlen), "decrypt");
	zassert_equal(ptlen, sizeof(KAT_BLOB_PT), "roundtrip length");
	zassert_mem_equal(pt, KAT_BLOB_PT, sizeof(KAT_BLOB_PT), "roundtrip");
}

ZTEST(crypto_kat, encrypt_blob_nonce_is_fresh)
{
	uint8_t a[128], b[128];
	size_t la = sizeof(a), lb = sizeof(b);

	zassert_ok(crypto_encrypt_blob(KAT_BLOB_KEY, KAT_BLOB_PT, sizeof(KAT_BLOB_PT), a, &la),
		   "a");
	zassert_ok(crypto_encrypt_blob(KAT_BLOB_KEY, KAT_BLOB_PT, sizeof(KAT_BLOB_PT), b, &lb),
		   "b");

	/* A repeated GCM nonce under the same key is a total break, so this is
	 * checked rather than assumed of the TRNG wiring. */
	zassert_true(memcmp(a, b, 12) != 0, "nonce repeated across calls");
}

ZTEST(crypto_kat, decrypt_blob_rejects_a_tampered_tag)
{
	uint8_t blob[sizeof(KAT_BLOB)];
	uint8_t pt[64];
	size_t len = sizeof(pt);

	memcpy(blob, KAT_BLOB, sizeof(blob));
	blob[sizeof(blob) - 1] ^= 0x01;

	zassert_equal(crypto_decrypt_blob(KAT_BLOB_KEY, blob, sizeof(blob), pt, &len), -EBADMSG,
		      "a corrupted tag must be -EBADMSG, not a silent pass");
}

ZTEST(crypto_kat, decrypt_blob_rejects_a_tampered_ciphertext)
{
	uint8_t blob[sizeof(KAT_BLOB)];
	uint8_t pt[64];
	size_t len = sizeof(pt);

	memcpy(blob, KAT_BLOB, sizeof(blob));
	blob[20] ^= 0x01;

	zassert_equal(crypto_decrypt_blob(KAT_BLOB_KEY, blob, sizeof(blob), pt, &len), -EBADMSG,
		      "a corrupted blob body must be -EBADMSG");
}

/* ── TRNG ────────────────────────────────────────────────────────────── */

ZTEST(crypto_kat, trng_does_not_repeat)
{
	uint8_t a[32], b[32];

	zassert_ok(crypto_trng(a, sizeof(a)), "trng a");
	zassert_ok(crypto_trng(b, sizeof(b)), "trng b");
	zassert_true(memcmp(a, b, sizeof(a)) != 0, "TRNG returned twice alike");
}
```

## src/vectors.h
```c
/* SPDX-License-Identifier: GPL-3.0-or-later */
/* Generated by gen_vectors.py — do not edit. */

#pragma once

#include <stdint.h>

static const uint8_t KAT_STORAGE_KEY[32] = {0xe5, 0xb1, 0xd7, 0x53, 0xf1, 0xc9, 0xbd, 0xbc,
					    0xd7, 0x2b, 0x2a, 0x2d, 0x38, 0x55, 0xa0, 0x60,
					    0xcb, 0x70, 0xbc, 0x95, 0x71, 0xa5, 0xcf, 0x81,
					    0x38, 0x9b, 0x8d, 0xc8, 0xd3, 0x1e, 0xbc, 0x6a};

static const uint8_t KAT_P256_PRIV[32] = {0xc9, 0xaf, 0xa9, 0xd8, 0x45, 0xba, 0x75, 0x16,
					  0x6b, 0x5c, 0x21, 0x57, 0x67, 0xb1, 0xd6, 0x93,
					  0x4e, 0x50, 0xc3, 0xdb, 0x36, 0xe8, 0x9b, 0x12,
					  0x7b, 0x8a, 0x62, 0x2b, 0x12, 0x0f, 0x67, 0x21};
static const uint8_t KAT_P256_PUB[65] = {
	0x04, 0x60, 0xfe, 0xd4, 0xba, 0x25, 0x5a, 0x9d, 0x31, 0xc9, 0x61, 0xeb, 0x74,
	0xc6, 0x35, 0x6d, 0x68, 0xc0, 0x49, 0xb8, 0x92, 0x3b, 0x61, 0xfa, 0x6c, 0xe6,
	0x69, 0x62, 0x2e, 0x60, 0xf2, 0x9f, 0xb6, 0x79, 0x03, 0xfe, 0x10, 0x08, 0xb8,
	0xbc, 0x99, 0xa4, 0x1a, 0xe9, 0xe9, 0x56, 0x28, 0xbc, 0x64, 0xf2, 0xf1, 0xb2,
	0x0c, 0x2d, 0x7e, 0x9f, 0x51, 0x77, 0xa3, 0xc2, 0x94, 0xd4, 0x46, 0x22, 0x99};
static const uint8_t KAT_P256_DIGEST[32] = {0xaf, 0x2b, 0xdb, 0xe1, 0xaa, 0x9b, 0x6e, 0xc1,
					    0xe2, 0xad, 0xe1, 0xd6, 0x94, 0xf4, 0x1f, 0xc7,
					    0x1a, 0x83, 0x1d, 0x02, 0x68, 0xe9, 0x89, 0x15,
					    0x62, 0x11, 0x3d, 0x8a, 0x62, 0xad, 0xd1, 0xbf};
static const uint8_t KAT_P256_SIG[64] = {
	0xef, 0xd4, 0x8b, 0x2a, 0xac, 0xb6, 0xa8, 0xfd, 0x11, 0x40, 0xdd, 0x9c, 0xd4,
	0x5e, 0x81, 0xd6, 0x9d, 0x2c, 0x87, 0x7b, 0x56, 0xaa, 0xf9, 0x91, 0xc3, 0x4d,
	0x0e, 0xa8, 0x4e, 0xaf, 0x37, 0x16, 0xf7, 0xcb, 0x1c, 0x94, 0x2d, 0x65, 0x7c,
	0x41, 0xd4, 0x36, 0xc7, 0xa1, 0xb6, 0xe2, 0x9f, 0x65, 0xf3, 0xe9, 0x00, 0xdb,
	0xb9, 0xaf, 0xf4, 0x06, 0x4d, 0xc4, 0xab, 0x2f, 0x84, 0x3a, 0xcd, 0xa8};

static const uint8_t KAT_HKDF_IKM[22] = {0x0b, 0x0b, 0x0b, 0x0b, 0x0b, 0x0b, 0x0b, 0x0b,
					 0x0b, 0x0b, 0x0b, 0x0b, 0x0b, 0x0b, 0x0b, 0x0b,
					 0x0b, 0x0b, 0x0b, 0x0b, 0x0b, 0x0b};
static const uint8_t KAT_HKDF_SALT[13] = {0x00, 0x01, 0x02, 0x03, 0x04, 0x05, 0x06,
					  0x07, 0x08, 0x09, 0x0a, 0x0b, 0x0c};
static const uint8_t KAT_HKDF_INFO[10] = {0xf0, 0xf1, 0xf2, 0xf3, 0xf4,
					  0xf5, 0xf6, 0xf7, 0xf8, 0xf9};
static const uint8_t KAT_HKDF_OKM[42] = {
	0x3c, 0xb2, 0x5f, 0x25, 0xfa, 0xac, 0xd5, 0x7a, 0x90, 0x43, 0x4f, 0x64, 0xd0, 0x36,
	0x2f, 0x2a, 0x2d, 0x2d, 0x0a, 0x90, 0xcf, 0x1a, 0x5a, 0x4c, 0x5d, 0xb0, 0x2d, 0x56,
	0xec, 0xc4, 0xc5, 0xbf, 0x34, 0x00, 0x72, 0x08, 0xd5, 0xb8, 0x87, 0x18, 0x58, 0x65};

#define KAT_PSK_PASSKEY 123456u
static const uint8_t KAT_PSK_LOCAL[32] = {0x00, 0x01, 0x02, 0x03, 0x04, 0x05, 0x06, 0x07,
					  0x08, 0x09, 0x0a, 0x0b, 0x0c, 0x0d, 0x0e, 0x0f,
					  0x10, 0x11, 0x12, 0x13, 0x14, 0x15, 0x16, 0x17,
					  0x18, 0x19, 0x1a, 0x1b, 0x1c, 0x1d, 0x1e, 0x1f};
static const uint8_t KAT_PSK_REMOTE[32] = {0x20, 0x21, 0x22, 0x23, 0x24, 0x25, 0x26, 0x27,
					   0x28, 0x29, 0x2a, 0x2b, 0x2c, 0x2d, 0x2e, 0x2f,
					   0x30, 0x31, 0x32, 0x33, 0x34, 0x35, 0x36, 0x37,
					   0x38, 0x39, 0x3a, 0x3b, 0x3c, 0x3d, 0x3e, 0x3f};
static const uint8_t KAT_PSK[32] = {0xf7, 0x73, 0xe8, 0x0c, 0xae, 0x0a, 0xd6, 0xd1,
				    0x58, 0xfa, 0xa3, 0xca, 0x40, 0xad, 0x62, 0xdd,
				    0x2d, 0x9c, 0x70, 0xb4, 0xc2, 0xb6, 0xe4, 0xc2,
				    0x37, 0x8b, 0x63, 0x20, 0x20, 0xa4, 0xfb, 0xce};

static const uint8_t KAT_BLOB_KEY[32] = {0x00, 0x01, 0x02, 0x03, 0x04, 0x05, 0x06, 0x07,
					 0x08, 0x09, 0x0a, 0x0b, 0x0c, 0x0d, 0x0e, 0x0f,
					 0x10, 0x11, 0x12, 0x13, 0x14, 0x15, 0x16, 0x17,
					 0x18, 0x19, 0x1a, 0x1b, 0x1c, 0x1d, 0x1e, 0x1f};
static const uint8_t KAT_BLOB_PT[44] = {
	0x63, 0x61, 0x6e, 0x74, 0x69, 0x6c, 0x20, 0x6b, 0x65, 0x79, 0x20, 0x62, 0x6c, 0x6f, 0x62,
	0x20, 0x70, 0x6c, 0x61, 0x69, 0x6e, 0x74, 0x65, 0x78, 0x74, 0x2c, 0x20, 0x34, 0x34, 0x20,
	0x62, 0x79, 0x74, 0x65, 0x73, 0x20, 0x6c, 0x6f, 0x6e, 0x67, 0x2e, 0x2e, 0x2e, 0x2e};
static const uint8_t KAT_BLOB[72] = {
	0x00, 0x01, 0x02, 0x03, 0x04, 0x05, 0x06, 0x07, 0x08, 0x09, 0x0a, 0x0b, 0x24, 0x63, 0xb8,
	0x6f, 0xac, 0x89, 0xe2, 0x70, 0xe8, 0x38, 0xb7, 0xe9, 0xdd, 0x86, 0x1a, 0x4d, 0xf3, 0xba,
	0xe6, 0x5d, 0x9e, 0x0f, 0x3a, 0x04, 0x4c, 0x4b, 0xc5, 0xb1, 0x29, 0x49, 0x62, 0xcb, 0x75,
	0x75, 0xdd, 0xdc, 0xc3, 0xae, 0x7c, 0xff, 0x5a, 0x8a, 0x51, 0xc3, 0x18, 0x8e, 0xa3, 0x73,
	0x60, 0x3e, 0xeb, 0x44, 0xf0, 0x37, 0x8d, 0xcc, 0x44, 0xd7, 0x74, 0x54};
```
