## CMakeLists.txt
```
# SPDX-License-Identifier: GPL-3.0-or-later
#
# ztest suite for noise_crypto_wolfssl.c — RFC/known-answer vectors for the six
# primitives that back the Noise_XX state machine.
#
# A sibling directory used to run this same src/main.c against the mbedTLS
# backend, and that cross-check is what made the vectors meaningful while two
# backends existed. It is not what makes them meaningful now: gen_vectors.py
# produces every vector from published test data and Python, so a pass says
# wolfCrypt agrees with a third implementation rather than with itself. That
# matters beyond this device — a host speaking Noise to it derives the same
# keys from the same standard, and a handshake fails opaquely if they diverge.
#
# Build + run:
#   ./scripts/test.sh noise_crypto

cmake_minimum_required(VERSION 3.20.0)

find_package(Zephyr REQUIRED HINTS $ENV{ZEPHYR_BASE})
project(noise_crypto_tests LANGUAGES C)

set(FW ${CMAKE_CURRENT_SOURCE_DIR}/../..)

target_sources(app PRIVATE
    src/main.c
    ${FW}/src/session/noise_crypto_wolfssl.c
    ${FW}/src/crypto/zeroize.c
    ${FW}/src/crypto/wc_rand.c
)

target_include_directories(app PRIVATE
    src
    ${FW}/src
    ${FW}/src/session
)

# cantil_wolfssl_user_settings.h lives here; the wolfSSL module resolves
# CONFIG_WOLFSSL_SETTINGS_FILE against the include path.
zephyr_include_directories(${FW}/include)

# Carries WOLFSSL_USER_SETTINGS / WOLFSSL_ZEPHYR.  Without it `app` would
# compile the wolfssl headers under a different configuration than the library
# was built with — which fails in ways that look like ABI corruption rather
# than a missing define.
target_link_libraries(app PRIVATE wolfSSL)
```

## prj.conf
```kconfig
# ztest framework
CONFIG_ZTEST=y

# noise_crypto_dh_keygen() draws from the Zephyr entropy device, and
# wolfCrypt's curve25519 blinding opens an RNG of its own from inside
# wc_curve25519_generic().
CONFIG_ENTROPY_GENERATOR=y
CONFIG_TEST_RANDOM_GENERATOR=y

# wolfCrypt.  Which primitives get compiled is decided by the settings header,
# not by Kconfig — see firmware/include/cantil_wolfssl_user_settings.h.
CONFIG_WOLFSSL=y
CONFIG_WOLFSSL_BUILTIN=y
CONFIG_WOLFSSL_SETTINGS_FILE="cantil_wolfssl_user_settings.h"

CONFIG_MAIN_STACK_SIZE=8192
CONFIG_HEAP_MEM_POOL_SIZE=16384
```

## src/main.c
```c
/* SPDX-License-Identifier: GPL-3.0-or-later */
/* See LICENSE at the repo root. */

#include <zephyr/kernel.h>
#include <zephyr/ztest.h>
#include <string.h>

#include "noise_crypto.h"
#include "vectors.h"

ZTEST_SUITE(noise_crypto, NULL, NULL, NULL, NULL, NULL);

/* ── X25519 KAT (RFC 7748 §6.1) ──────────────────────────────────────── */

ZTEST(noise_crypto, x25519_alice_derives_pub)
{
	uint8_t pub[32];
	uint8_t shared[32];

	/* Re-derive Alice's public key by DH(alice_priv, basepoint).
	 * X25519 basepoint = 9 || 0...0 — encode directly.
	 */
	uint8_t basepoint[32] = {9};

	zassert_ok(noise_crypto_dh(shared, X25519_ALICE_PRIV, basepoint), "DH(alice, basepoint)");
	zassert_mem_equal(shared, X25519_ALICE_PUB, 32, "alice pub mismatch");
}

ZTEST(noise_crypto, x25519_bob_derives_pub)
{
	uint8_t basepoint[32] = {9};
	uint8_t pub[32];

	zassert_ok(noise_crypto_dh(pub, X25519_BOB_PRIV, basepoint), "DH(bob, basepoint)");
	zassert_mem_equal(pub, X25519_BOB_PUB, 32, "bob pub mismatch");
}

ZTEST(noise_crypto, x25519_shared_secret_both_directions)
{
	uint8_t s_ab[32], s_ba[32];

	zassert_ok(noise_crypto_dh(s_ab, X25519_ALICE_PRIV, X25519_BOB_PUB), "DH(alice, bob_pub)");
	zassert_ok(noise_crypto_dh(s_ba, X25519_BOB_PRIV, X25519_ALICE_PUB), "DH(bob, alice_pub)");
	zassert_mem_equal(s_ab, X25519_SHARED, 32, "ab shared mismatch");
	zassert_mem_equal(s_ba, X25519_SHARED, 32, "ba shared mismatch");
}

ZTEST(noise_crypto, x25519_keygen_roundtrip)
{
	uint8_t priv[32], pub[32], pub_check[32];
	uint8_t basepoint[32] = {9};

	zassert_ok(noise_crypto_dh_keygen(priv, pub), "keygen");

	/* Clamping invariants per RFC 7748 §5. */
	zassert_equal(priv[0] & 7, 0, "low 3 bits not cleared");
	zassert_equal(priv[31] & 0x80, 0, "top bit not cleared");
	zassert_equal(priv[31] & 0x40, 0x40, "bit 254 not set");

	zassert_ok(noise_crypto_dh(pub_check, priv, basepoint), "redrive pub from priv");
	zassert_mem_equal(pub, pub_check, 32, "keygen pub != DH(priv, base)");
}

/* ── SHA-256 KAT ─────────────────────────────────────────────────────── */

ZTEST(noise_crypto, sha256_abc_split_input)
{
	/* noise_crypto_hash takes two halves — feed "a" || "bc" = "abc". */
	uint8_t out[32];

	zassert_ok(noise_crypto_hash(out, SHA256_ABC_A, sizeof(SHA256_ABC_A), SHA256_ABC_BC,
				     sizeof(SHA256_ABC_BC)),
		   "hash");
	zassert_mem_equal(out, SHA256_ABC_HASH, 32, "SHA-256(abc) mismatch");
}

ZTEST(noise_crypto, sha256_empty)
{
	/* SHA-256("") = e3b0c44298fc1c149afbf4c8996fb92427ae41e4649b934ca495991b7852b855 */
	static const uint8_t expected[32] = {
		0xe3, 0xb0, 0xc4, 0x42, 0x98, 0xfc, 0x1c, 0x14, 0x9a, 0xfb, 0xf4,
		0xc8, 0x99, 0x6f, 0xb9, 0x24, 0x27, 0xae, 0x41, 0xe4, 0x64, 0x9b,
		0x93, 0x4c, 0xa4, 0x95, 0x99, 0x1b, 0x78, 0x52, 0xb8, 0x55,
	};
	uint8_t out[32];

	zassert_ok(noise_crypto_hash(out, NULL, 0, NULL, 0), "hash empty");
	zassert_mem_equal(out, expected, 32, "SHA-256(empty) mismatch");
}

/* ── ChaCha20-Poly1305 KAT ──────────────────────────────────────────── */

ZTEST(noise_crypto, aead_encrypt_n0)
{
	uint8_t ct[sizeof(AEAD_PT1) + 16];
	size_t ct_len = 0;

	zassert_ok(noise_crypto_encrypt(ct, sizeof(ct), &ct_len, AEAD_KEY1, 0, AEAD_AD1,
					sizeof(AEAD_AD1), AEAD_PT1, sizeof(AEAD_PT1)),
		   "encrypt n=0");
	zassert_equal(ct_len, sizeof(AEAD_CT1_N0), "ct length");
	zassert_mem_equal(ct, AEAD_CT1_N0, ct_len, "ct n=0 mismatch");
}

ZTEST(noise_crypto, aead_encrypt_n1_differs)
{
	uint8_t ct[sizeof(AEAD_PT1) + 16];
	size_t ct_len = 0;

	zassert_ok(noise_crypto_encrypt(ct, sizeof(ct), &ct_len, AEAD_KEY1, 1, AEAD_AD1,
					sizeof(AEAD_AD1), AEAD_PT1, sizeof(AEAD_PT1)),
		   "encrypt n=1");
	zassert_mem_equal(ct, AEAD_CT1_N1, ct_len, "ct n=1 mismatch");
	/* Cross-check the nonce-encoding bug class: same inputs, nonce only
	 * differs in the uint64 counter — outputs must differ.
	 */
	zassert_true(memcmp(AEAD_CT1_N0, AEAD_CT1_N1, ct_len) != 0,
		     "n=0 and n=1 ciphertexts must differ");
}

ZTEST(noise_crypto, aead_decrypt_n0)
{
	uint8_t pt[sizeof(AEAD_PT1)];
	size_t pt_len = 0;

	zassert_ok(noise_crypto_decrypt(pt, sizeof(pt), &pt_len, AEAD_KEY1, 0, AEAD_AD1,
					sizeof(AEAD_AD1), AEAD_CT1_N0, sizeof(AEAD_CT1_N0)),
		   "decrypt n=0");
	zassert_equal(pt_len, sizeof(AEAD_PT1), "pt length");
	zassert_mem_equal(pt, AEAD_PT1, pt_len, "pt mismatch");
}

ZTEST(noise_crypto, aead_decrypt_wrong_nonce_fails)
{
	uint8_t pt[sizeof(AEAD_PT1)];
	size_t pt_len = 0;

	int rc = noise_crypto_decrypt(pt, sizeof(pt), &pt_len, AEAD_KEY1, 1, /* wrong nonce */
				      AEAD_AD1, sizeof(AEAD_AD1), AEAD_CT1_N0, sizeof(AEAD_CT1_N0));
	zassert_equal(rc, -EBADMSG, "expected auth failure, got %d", rc);
}

ZTEST(noise_crypto, aead_decrypt_tampered_tag_fails)
{
	uint8_t ct[sizeof(AEAD_CT1_N0)];
	uint8_t pt[sizeof(AEAD_PT1)];
	size_t pt_len = 0;

	memcpy(ct, AEAD_CT1_N0, sizeof(ct));
	ct[sizeof(ct) - 1] ^= 0x01; /* flip a tag byte */

	int rc = noise_crypto_decrypt(pt, sizeof(pt), &pt_len, AEAD_KEY1, 0, AEAD_AD1,
				      sizeof(AEAD_AD1), ct, sizeof(ct));
	zassert_equal(rc, -EBADMSG, "expected auth failure, got %d", rc);
}

ZTEST(noise_crypto, aead_decrypt_tampered_ad_fails)
{
	uint8_t bad_ad[sizeof(AEAD_AD1)];
	uint8_t pt[sizeof(AEAD_PT1)];
	size_t pt_len = 0;

	memcpy(bad_ad, AEAD_AD1, sizeof(bad_ad));
	bad_ad[0] ^= 0x01;

	int rc = noise_crypto_decrypt(pt, sizeof(pt), &pt_len, AEAD_KEY1, 0, bad_ad, sizeof(bad_ad),
				      AEAD_CT1_N0, sizeof(AEAD_CT1_N0));
	zassert_equal(rc, -EBADMSG, "expected auth failure, got %d", rc);
}

ZTEST(noise_crypto, aead_empty_plaintext)
{
	/* Noise handshake messages frequently AEAD-encrypt an empty payload. */
	uint8_t ct[16];
	size_t ct_len = 0;

	zassert_ok(
		noise_crypto_encrypt(ct, sizeof(ct), &ct_len, AEAD_KEY3_ZERO, 0, NULL, 0, NULL, 0),
		"encrypt empty");
	zassert_equal(ct_len, 16, "empty ct must be tag-only (16 bytes)");
	zassert_mem_equal(ct, AEAD_CT3_EMPTY, 16, "empty ct mismatch");
}

/* ── HKDF-2 KAT ─────────────────────────────────────────────────────── */

ZTEST(noise_crypto, hkdf2_basic)
{
	uint8_t o1[32], o2[32];

	zassert_ok(noise_crypto_hkdf2(o1, o2, HKDF_CK, HKDF_IKM, sizeof(HKDF_IKM)), "hkdf2");
	zassert_mem_equal(o1, HKDF_OUT1, 32, "hkdf2 out1 mismatch");
	zassert_mem_equal(o2, HKDF_OUT2, 32, "hkdf2 out2 mismatch");
}

ZTEST(noise_crypto, hkdf2_empty_ikm)
{
	/* Noise Split() calls HKDF-2 with empty ikm. */
	uint8_t o1[32], o2[32];

	zassert_ok(noise_crypto_hkdf2(o1, o2, HKDF_CK, NULL, 0), "hkdf2 empty ikm");
	zassert_mem_equal(o1, HKDF_OUT1_EMPTY, 32, "hkdf2 empty out1 mismatch");
	zassert_mem_equal(o2, HKDF_OUT2_EMPTY, 32, "hkdf2 empty out2 mismatch");
}
```

## src/vectors.h
```c
/* SPDX-License-Identifier: GPL-3.0-or-later */
/* GENERATED by gen_vectors.py — do not edit by hand. */
#pragma once

#include <stdint.h>
#include <stddef.h>

/* X25519 — RFC 7748 §6.1 */
static const uint8_t X25519_ALICE_PRIV[32] = {0x77, 0x07, 0x6d, 0x0a, 0x73, 0x18, 0xa5, 0x7d,
					      0x3c, 0x16, 0xc1, 0x72, 0x51, 0xb2, 0x66, 0x45,
					      0xdf, 0x4c, 0x2f, 0x87, 0xeb, 0xc0, 0x99, 0x2a,
					      0xb1, 0x77, 0xfb, 0xa5, 0x1d, 0xb9, 0x2c, 0x2a};
static const uint8_t X25519_ALICE_PUB[32] = {0x85, 0x20, 0xf0, 0x09, 0x89, 0x30, 0xa7, 0x54,
					     0x74, 0x8b, 0x7d, 0xdc, 0xb4, 0x3e, 0xf7, 0x5a,
					     0x0d, 0xbf, 0x3a, 0x0d, 0x26, 0x38, 0x1a, 0xf4,
					     0xeb, 0xa4, 0xa9, 0x8e, 0xaa, 0x9b, 0x4e, 0x6a};
static const uint8_t X25519_BOB_PRIV[32] = {0x5d, 0xab, 0x08, 0x7e, 0x62, 0x4a, 0x8a, 0x4b,
					    0x79, 0xe1, 0x7f, 0x8b, 0x83, 0x80, 0x0e, 0xe6,
					    0x6f, 0x3b, 0xb1, 0x29, 0x26, 0x18, 0xb6, 0xfd,
					    0x1c, 0x2f, 0x8b, 0x27, 0xff, 0x88, 0xe0, 0xeb};
static const uint8_t X25519_BOB_PUB[32] = {0xde, 0x9e, 0xdb, 0x7d, 0x7b, 0x7d, 0xc1, 0xb4,
					   0xd3, 0x5b, 0x61, 0xc2, 0xec, 0xe4, 0x35, 0x37,
					   0x3f, 0x83, 0x43, 0xc8, 0x5b, 0x78, 0x67, 0x4d,
					   0xad, 0xfc, 0x7e, 0x14, 0x6f, 0x88, 0x2b, 0x4f};
static const uint8_t X25519_SHARED[32] = {0x4a, 0x5d, 0x9d, 0x5b, 0xa4, 0xce, 0x2d, 0xe1,
					  0x72, 0x8e, 0x3b, 0xf4, 0x80, 0x35, 0x0f, 0x25,
					  0xe0, 0x7e, 0x21, 0xc9, 0x47, 0xd1, 0x9e, 0x33,
					  0x76, 0xf0, 0x9b, 0x3c, 0x1e, 0x16, 0x17, 0x42};

/* SHA-256("abc") — FIPS 180-2 */
static const uint8_t SHA256_ABC_A[1] = {0x61};
static const uint8_t SHA256_ABC_BC[2] = {0x62, 0x63};
static const uint8_t SHA256_ABC_HASH[32] = {0xba, 0x78, 0x16, 0xbf, 0x8f, 0x01, 0xcf, 0xea,
					    0x41, 0x41, 0x40, 0xde, 0x5d, 0xae, 0x22, 0x23,
					    0xb0, 0x03, 0x61, 0xa3, 0x96, 0x17, 0x7a, 0x9c,
					    0xb4, 0x10, 0xff, 0x61, 0xf2, 0x00, 0x15, 0xad};

/* ChaCha20-Poly1305 with Noise nonce (4 zero bytes || uint64 LE) */
static const uint8_t AEAD_KEY1[32] = {0x1c, 0x92, 0x40, 0xa5, 0xeb, 0x55, 0xd3, 0x8a,
				      0xf3, 0x33, 0x88, 0x86, 0x04, 0xf6, 0xb5, 0xf0,
				      0x47, 0x39, 0x17, 0xc1, 0x40, 0x2b, 0x80, 0x09,
				      0x9d, 0xca, 0x5c, 0xbc, 0x20, 0x70, 0x75, 0xc0};
static const uint8_t AEAD_AD1[4] = {0xf3, 0x33, 0x88, 0x86};
static const uint8_t AEAD_PT1[69] = {
	0x49, 0x6e, 0x74, 0x65, 0x72, 0x6e, 0x65, 0x74, 0x2d, 0x44, 0x72, 0x61, 0x66, 0x74,
	0x73, 0x20, 0x61, 0x72, 0x65, 0x20, 0x64, 0x72, 0x61, 0x66, 0x74, 0x20, 0x64, 0x6f,
	0x63, 0x75, 0x6d, 0x65, 0x6e, 0x74, 0x73, 0x20, 0x76, 0x61, 0x6c, 0x69, 0x64, 0x20,
	0x66, 0x6f, 0x72, 0x20, 0x61, 0x20, 0x6d, 0x61, 0x78, 0x69, 0x6d, 0x75, 0x6d, 0x20,
	0x6f, 0x66, 0x20, 0x73, 0x69, 0x78, 0x20, 0x6d, 0x6f, 0x6e, 0x74, 0x68, 0x73};
static const uint8_t AEAD_CT1_N0[85] = {
	0x96, 0x1b, 0x89, 0xba, 0x40, 0xb1, 0x38, 0x65, 0x12, 0x11, 0x5e, 0x5d, 0xc6, 0x34, 0xe5,
	0xe0, 0x77, 0xda, 0x77, 0x4f, 0xcf, 0xd3, 0x4e, 0x5b, 0x16, 0x12, 0x74, 0x8a, 0xd9, 0x1c,
	0xa7, 0x97, 0xd7, 0x39, 0x06, 0x81, 0x71, 0xb7, 0xeb, 0xdc, 0xda, 0x81, 0xf9, 0x84, 0xe6,
	0x40, 0x0f, 0x4c, 0x9a, 0xa1, 0xa5, 0x2e, 0x84, 0xce, 0xcf, 0xbe, 0x9f, 0x5a, 0xed, 0xe1,
	0x46, 0xc4, 0xb0, 0x86, 0xf2, 0xf3, 0xe1, 0xb2, 0x06, 0x08, 0x5e, 0xba, 0x28, 0xb2, 0x87,
	0xdd, 0x20, 0x27, 0x29, 0xe8, 0x8d, 0x75, 0x97, 0x32, 0x61};
static const uint8_t AEAD_CT1_N1[85] = {
	0x78, 0xb6, 0x9a, 0x03, 0xed, 0xc2, 0xcc, 0x21, 0xa1, 0xfb, 0x8c, 0xf6, 0x54, 0xa9, 0x4c,
	0xa9, 0x8c, 0xfe, 0x8d, 0x49, 0x21, 0xe6, 0x18, 0x22, 0x93, 0x87, 0x34, 0x86, 0x95, 0xf2,
	0x3f, 0xa4, 0x8a, 0x3d, 0x8e, 0x71, 0x79, 0xdd, 0xe8, 0xbb, 0xf4, 0xa2, 0x9d, 0x6c, 0xa3,
	0x52, 0x80, 0x17, 0xa9, 0xdb, 0x75, 0x96, 0x9e, 0xdb, 0x88, 0xed, 0xfa, 0x5c, 0x92, 0x16,
	0x48, 0xfb, 0x1f, 0x0c, 0xa5, 0x01, 0x48, 0x69, 0x48, 0xe8, 0xbe, 0xfd, 0x70, 0x68, 0x5c,
	0xaa, 0x36, 0x33, 0x32, 0x0a, 0x88, 0x02, 0x60, 0xed, 0x6f};
static const uint8_t AEAD_KEY3_ZERO[32] = {0x00, 0x00, 0x00, 0x00, 0x00, 0x00, 0x00, 0x00,
					   0x00, 0x00, 0x00, 0x00, 0x00, 0x00, 0x00, 0x00,
					   0x00, 0x00, 0x00, 0x00, 0x00, 0x00, 0x00, 0x00,
					   0x00, 0x00, 0x00, 0x00, 0x00, 0x00, 0x00, 0x00};
static const uint8_t AEAD_CT3_EMPTY[16] = {0x4e, 0xb9, 0x72, 0xc9, 0xa8, 0xfb, 0x3a, 0x1b,
					   0x38, 0x2b, 0xb4, 0xd3, 0x6f, 0x5f, 0xfa, 0xd1};

/* Noise HKDF-2: HKDF-SHA-256(salt=ck, ikm), 64-byte output split */
static const uint8_t HKDF_CK[32] = {0x0b, 0x0b, 0x0b, 0x0b, 0x0b, 0x0b, 0x0b, 0x0b,
				    0x0b, 0x0b, 0x0b, 0x0b, 0x0b, 0x0b, 0x0b, 0x0b,
				    0x0b, 0x0b, 0x0b, 0x0b, 0x0b, 0x0b, 0x0b, 0x0b,
				    0x0b, 0x0b, 0x0b, 0x0b, 0x0b, 0x0b, 0x0b, 0x0b};
static const uint8_t HKDF_IKM[21] = {0x69, 0x6e, 0x70, 0x75, 0x74, 0x20, 0x6b,
				     0x65, 0x79, 0x69, 0x6e, 0x67, 0x20, 0x6d,
				     0x61, 0x74, 0x65, 0x72, 0x69, 0x61, 0x6c};
static const uint8_t HKDF_OUT1[32] = {0x2d, 0xe2, 0xa8, 0x07, 0x23, 0xb6, 0xc5, 0x6e,
				      0x69, 0xa7, 0x1b, 0x27, 0x69, 0xe5, 0x7f, 0x24,
				      0x21, 0xf1, 0x27, 0xeb, 0x13, 0x8b, 0xdc, 0xf0,
				      0x0a, 0x4d, 0x0f, 0x98, 0x80, 0xd4, 0xdf, 0xd5};
static const uint8_t HKDF_OUT2[32] = {0x3e, 0xda, 0xd0, 0x71, 0x93, 0x08, 0x0f, 0x9c,
				      0xe9, 0x2b, 0xd7, 0x26, 0xa9, 0x0d, 0xb4, 0x2c,
				      0x64, 0x47, 0x93, 0xfd, 0x7d, 0x59, 0xf4, 0x18,
				      0x81, 0x03, 0x9c, 0x40, 0x96, 0x3e, 0x32, 0xbe};

/* Noise HKDF-2 with empty ikm — used by Split() */
static const uint8_t HKDF_OUT1_EMPTY[32] = {0x59, 0x3b, 0xae, 0x66, 0x09, 0x36, 0x14, 0x7b,
					    0xea, 0x3a, 0xd5, 0x70, 0xe9, 0xf3, 0x7c, 0xcc,
					    0xa1, 0x1f, 0x9d, 0x09, 0xf9, 0xb9, 0x9b, 0xd9,
					    0x84, 0x72, 0x40, 0x91, 0x07, 0xe4, 0x33, 0x5e};
static const uint8_t HKDF_OUT2_EMPTY[32] = {0xa3, 0x1f, 0x59, 0xa2, 0x43, 0xe2, 0x75, 0x2d,
					    0x2e, 0x1f, 0x9b, 0x66, 0xa0, 0xa8, 0x27, 0x04,
					    0x8b, 0x79, 0xb8, 0x80, 0xeb, 0xee, 0x9e, 0xa8,
					    0x98, 0x71, 0xd4, 0x2c, 0xf7, 0x5a, 0x24, 0xcf};
```
